/* ASAP2 file for OpenECU and ETAS INCA calibration tool.
* Auto-generated from 'capi.py' (version 2.9.0 (r2020-1)) at Mon Jan 10 18:15:28 2022 (local time).
* Information taken from:
* testmodel.dde_group.tmp
* automatic library DDEs
*/ ASAP2_VERSION 1 31
/begin PROJECT New_model_v1.0.0_M220_000 "Throttle Control"
/begin HEADER "(none)" VERSION "1_0_0" /end HEADER
/begin MODULE OpenECU_M220_000 ""
/begin MOD_PAR ""
 /begin MEMORY_SEGMENT Strategy "Strategy/application code" CODE FLASH INTERN 0x80000 0x7ffc0 -1 -1 -1 -1 -1 /end MEMORY_SEGMENT
 /begin MEMORY_SEGMENT Calibration "Calibration data" DATA FLASH INTERN 0x40000 0x40000 -1 -1 -1 -1 -1 /end MEMORY_SEGMENT
/end MOD_PAR
/begin IF_DATA ASAP1B_CCP
 /begin SOURCE "10_ms" 3 10 /* Rate in Scaling Unit: 10*1 ms */ /begin QP_BLOB 0 LENGTH 15 CAN_ID_FIXED 1784 RASTER 2 FIRST_PID 0 /end QP_BLOB /end SOURCE
 /begin SOURCE "100_ms" 3 100 /* Rate in Scaling Unit: 100*1 ms */ /begin QP_BLOB 1 LENGTH 15 CAN_ID_FIXED 1784 RASTER 5 FIRST_PID 15 /end QP_BLOB /end SOURCE
 /begin SOURCE "200_ms" 3 200 /* Rate in Scaling Unit: 200*1 ms */ /begin QP_BLOB 2 LENGTH 15 CAN_ID_FIXED 1784 RASTER 6 FIRST_PID 30 /end QP_BLOB /end SOURCE
 /begin SOURCE "1000_ms" 3 1000 /* Rate in Scaling Unit: 1000*1 ms */ /begin QP_BLOB 3 LENGTH 15 CAN_ID_FIXED 1784 RASTER 8 FIRST_PID 45 /end QP_BLOB /end SOURCE
 /begin RASTER "Time synchronous event channel - 10 ms" "10_ms" 2 /* Raster 2 (Reference from signal SOURCE)*/ 3 10 /* Rate in Scaling Unit: 10*1 ms */ /end RASTER
 /begin RASTER "Time synchronous event channel - 100 ms" "100_ms" 5 /* Raster 5 (Reference from signal SOURCE)*/ 3 100 /* Rate in Scaling Unit: 100*1 ms */ /end RASTER
 /begin RASTER "Time synchronous event channel - 200 ms" "200_ms" 6 /* Raster 6 (Reference from signal SOURCE)*/ 3 200 /* Rate in Scaling Unit: 200*1 ms */ /end RASTER
 /begin RASTER "Time synchronous event channel - 1000 ms" "1000_ms" 8 /* Raster 8 (Reference from signal SOURCE)*/ 3 1000 /* Rate in Scaling Unit: 1000*1 ms */ /end RASTER
 /begin TP_BLOB /* CCP version */ 0x201 /* Blob version */ 0x202 /* CAN msg ID - send */ 1785 /* CAN msg ID - recv */ 1784 /* station address */ 0 /* byte order */ 1
  /begin CAN_PARAM /* crystal frequency */ 0x1F4 /* timing register 0 */ 0x41 /* timing register 1 */ 0x25 /end CAN_PARAM
  /* Global measurement mode settings */ DAQ_MODE BURST CONSISTENCY ODT ADDRESS_EXTENSION ODT
  /begin CHECKSUM_PARAM /* algorithm */ 0x8006 /* limit */ 0xFFFFFFFF CHECKSUM_CALCULATION ACTIVE_PAGE /end CHECKSUM_PARAM
  /begin DEFINED_PAGES 1 "working page" /* address ext. */ 0x0 /* base address */ 0x40000 /* page length */ 0xaae RAM RAM_INIT_BY_ECU /end DEFINED_PAGES
  OPTIONAL_CMD 0x08 /* START_STOP_ALL */ OPTIONAL_CMD 0x0C /* SET_S_STATUS */ OPTIONAL_CMD 0x0D /* GET_S_STATUS */ OPTIONAL_CMD 0x0E /* BUILD_CHKSUM */ OPTIONAL_CMD 0x0F /* SHORT_UP */ OPTIONAL_CMD 0x10 /* CLEAR_MEMORY */ OPTIONAL_CMD 0x18 /* PROGRAM */ OPTIONAL_CMD 0x23 /* DNLOAD_6 */ OPTIONAL_CMD 0x22 /* PROGRAM_6 */ /end TP_BLOB
/end IF_DATA
/* Scalar measurable for DDE 'mpl_app_build_day'. */
/begin MEASUREMENT mpl_app_build_day "Date application was built in days." UWORD CU_MPL_APP_BUILD_DAY 1 100 0.0 65535.0 ECU_ADDRESS 0xb79a8 BYTE_ORDER MSB_FIRST /end MEASUREMENT
/begin COMPU_METHOD CU_MPL_APP_BUILD_DAY "Conversion method for mpl_app_build_day" RAT_FUNC "%10.0" "(not defined)" COEFFS 0.000000 1.000000 0.000000 0.000000 0.000000 1.000000 /end COMPU_METHOD
/* Scalar measurable for DDE 'mpl_app_build_hour'. */
/begin MEASUREMENT mpl_app_build_hour "Time application was built in hours" UWORD CU_MPL_APP_BUILD_HOUR 1 100 0.0 65535.0 ECU_ADDRESS 0xb79aa BYTE_ORDER MSB_FIRST /end MEASUREMENT
/begin COMPU_METHOD CU_MPL_APP_BUILD_HOUR "Conversion method for mpl_app_build_hour" RAT_FUNC "%10.0" "(not defined)" COEFFS 0.000000 1.000000 0.000000 0.000000 0.000000 1.000000 /end COMPU_METHOD
/* Scalar measurable for DDE 'mpl_app_build_min'. */
/begin MEASUREMENT mpl_app_build_min "Time application was built in minutes" UWORD CU_MPL_APP_BUILD_MIN 1 100 0.0 65535.0 ECU_ADDRESS 0xb79ac BYTE_ORDER MSB_FIRST /end MEASUREMENT
/begin COMPU_METHOD CU_MPL_APP_BUILD_MIN "Conversion method for mpl_app_build_min" RAT_FUNC "%10.0" "(not defined)" COEFFS 0.000000 1.000000 0.000000 0.000000 0.000000 1.000000 /end COMPU_METHOD
/* Scalar measurable for DDE 'mpl_app_build_month'. */
/begin MEASUREMENT mpl_app_build_month "Date application was built in months." UWORD CU_MPL_APP_BUILD_MONTH 1 100 0.0 65535.0 ECU_ADDRESS 0xb79a6 BYTE_ORDER MSB_FIRST /end MEASUREMENT
/begin COMPU_METHOD CU_MPL_APP_BUILD_MONTH "Conversion method for mpl_app_build_month" RAT_FUNC "%10.0" "(not defined)" COEFFS 0.000000 1.000000 0.000000 0.000000 0.000000 1.000000 /end COMPU_METHOD
/* Scalar measurable for DDE 'mpl_app_build_sec'. */
/begin MEASUREMENT mpl_app_build_sec "Time application was built in seconds" UWORD CU_MPL_APP_BUILD_SEC 1 100 0.0 65535.0 ECU_ADDRESS 0xb79ae BYTE_ORDER MSB_FIRST /end MEASUREMENT
/begin COMPU_METHOD CU_MPL_APP_BUILD_SEC "Conversion method for mpl_app_build_sec" RAT_FUNC "%10.0" "(not defined)" COEFFS 0.000000 1.000000 0.000000 0.000000 0.000000 1.000000 /end COMPU_METHOD
/* Scalar measurable for DDE 'mpl_app_build_year'. */
/begin MEASUREMENT mpl_app_build_year "Date application was built in years." UWORD CU_MPL_APP_BUILD_YEAR 1 100 0.0 65535.0 ECU_ADDRESS 0xb79a4 BYTE_ORDER MSB_FIRST /end MEASUREMENT
/begin COMPU_METHOD CU_MPL_APP_BUILD_YEAR "Conversion method for mpl_app_build_year" RAT_FUNC "%10.0" "(not defined)" COEFFS 0.000000 1.000000 0.000000 0.000000 0.000000 1.000000 /end COMPU_METHOD
/* Scalar measurable for DDE 'mpl_app_ver_major'. */
/begin MEASUREMENT mpl_app_ver_major "App major version number" UWORD CU_MPL_APP_VER_MAJOR 1 100 0.0 65535.0 ECU_ADDRESS 0x40aac BYTE_ORDER MSB_FIRST /end MEASUREMENT
/begin COMPU_METHOD CU_MPL_APP_VER_MAJOR "Conversion method for mpl_app_ver_major" RAT_FUNC "%10.0" "(not defined)" COEFFS 0.000000 1.000000 0.000000 0.000000 0.000000 1.000000 /end COMPU_METHOD
/* Scalar measurable for DDE 'mpl_app_ver_minor'. */
/begin MEASUREMENT mpl_app_ver_minor "App minor version number" UWORD CU_MPL_APP_VER_MINOR 1 100 0.0 65535.0 ECU_ADDRESS 0x40aaa BYTE_ORDER MSB_FIRST /end MEASUREMENT
/begin COMPU_METHOD CU_MPL_APP_VER_MINOR "Conversion method for mpl_app_ver_minor" RAT_FUNC "%10.0" "(not defined)" COEFFS 0.000000 1.000000 0.000000 0.000000 0.000000 1.000000 /end COMPU_METHOD
/* Scalar measurable for DDE 'mpl_app_ver_sub'. */
/begin MEASUREMENT mpl_app_ver_sub "App sub-minor version number" UWORD CU_MPL_APP_VER_SUB 1 100 0.0 65535.0 ECU_ADDRESS 0x40aa8 BYTE_ORDER MSB_FIRST /end MEASUREMENT
/begin COMPU_METHOD CU_MPL_APP_VER_SUB "Conversion method for mpl_app_ver_sub" RAT_FUNC "%10.0" "(not defined)" COEFFS 0.000000 1.000000 0.000000 0.000000 0.000000 1.000000 /end COMPU_METHOD
/* Scalar measurable for DDE 'mpl_boot_build_day'. */
/begin MEASUREMENT mpl_boot_build_day "Boot build day" UWORD CU_MPL_BOOT_BUILD_DAY 1 100 0.0 65535.0 ECU_ADDRESS 0x400025a2 BYTE_ORDER MSB_FIRST /end MEASUREMENT
/begin COMPU_METHOD CU_MPL_BOOT_BUILD_DAY "Conversion method for mpl_boot_build_day" RAT_FUNC "%10.0" "(not defined)" COEFFS 0.000000 1.000000 0.000000 0.000000 0.000000 1.000000 /end COMPU_METHOD
/* Scalar measurable for DDE 'mpl_boot_build_month'. */
/begin MEASUREMENT mpl_boot_build_month "Boot build month" UWORD CU_MPL_BOOT_BUILD_MONTH 1 100 0.0 65535.0 ECU_ADDRESS 0x400025a4 BYTE_ORDER MSB_FIRST /end MEASUREMENT
/begin COMPU_METHOD CU_MPL_BOOT_BUILD_MONTH "Conversion method for mpl_boot_build_month" RAT_FUNC "%10.0" "(not defined)" COEFFS 0.000000 1.000000 0.000000 0.000000 0.000000 1.000000 /end COMPU_METHOD
/* Scalar measurable for DDE 'mpl_boot_build_year'. */
/begin MEASUREMENT mpl_boot_build_year "Boot build year" UWORD CU_MPL_BOOT_BUILD_YEAR 1 100 0.0 65535.0 ECU_ADDRESS 0x400025a6 BYTE_ORDER MSB_FIRST /end MEASUREMENT
/begin COMPU_METHOD CU_MPL_BOOT_BUILD_YEAR "Conversion method for mpl_boot_build_year" RAT_FUNC "%10.0" "(not defined)" COEFFS 0.000000 1.000000 0.000000 0.000000 0.000000 1.000000 /end COMPU_METHOD
/* Scalar measurable for DDE 'mpl_boot_part_num_group'. */
/begin MEASUREMENT mpl_boot_part_num_group "Boot Group ID number in the part number" UBYTE CU_MPL_BOOT_PART_NUM_GROUP 1 100 0.0 255.0 ECU_ADDRESS 0x400025a8 BYTE_ORDER MSB_FIRST /end MEASUREMENT
/begin COMPU_METHOD CU_MPL_BOOT_PART_NUM_GROUP "Conversion method for mpl_boot_part_num_group" RAT_FUNC "%10.0" "(not defined)" COEFFS 0.000000 1.000000 0.000000 0.000000 0.000000 1.000000 /end COMPU_METHOD
/* Scalar measurable for DDE 'mpl_boot_part_num_id'. */
/begin MEASUREMENT mpl_boot_part_num_id "Boot Part ID in the part number" ULONG CU_MPL_BOOT_PART_NUM_ID 1 100 0.0 4294967295.0 ECU_ADDRESS 0x400025ac BYTE_ORDER MSB_FIRST /end MEASUREMENT
/begin COMPU_METHOD CU_MPL_BOOT_PART_NUM_ID "Conversion method for mpl_boot_part_num_id" RAT_FUNC "%10.0" "(not defined)" COEFFS 0.000000 1.000000 0.000000 0.000000 0.000000 1.000000 /end COMPU_METHOD
/* Scalar measurable for DDE 'mpl_boot_part_num_issue'. */
/begin MEASUREMENT mpl_boot_part_num_issue "Boot Issue Number in the part number" UWORD CU_MPL_BOOT_PART_NUM_ISSUE 1 100 0.0 65535.0 ECU_ADDRESS 0x400025b0 BYTE_ORDER MSB_FIRST /end MEASUREMENT
/begin COMPU_METHOD CU_MPL_BOOT_PART_NUM_ISSUE "Conversion method for mpl_boot_part_num_issue" RAT_FUNC "%10.0" "(not defined)" COEFFS 0.000000 1.000000 0.000000 0.000000 0.000000 1.000000 /end COMPU_METHOD
/* Scalar measurable for DDE 'mpl_boot_part_num_letter'. */
/begin MEASUREMENT mpl_boot_part_num_letter "Boot Group Letter in the part number" UBYTE CU_MPL_BOOT_PART_NUM_LETTER 1 100 0.0 255.0 ECU_ADDRESS 0x400025a9 BYTE_ORDER MSB_FIRST /end MEASUREMENT
/begin COMPU_METHOD CU_MPL_BOOT_PART_NUM_LETTER "Conversion method for mpl_boot_part_num_letter" RAT_FUNC "%10.0" "(not defined)" COEFFS 0.000000 1.000000 0.000000 0.000000 0.000000 1.000000 /end COMPU_METHOD
/* Scalar measurable for DDE 'mpl_boot_ver_major'. */
/begin MEASUREMENT mpl_boot_ver_major "Boot major version number" UWORD CU_MPL_BOOT_VER_MAJOR 1 100 0.0 65535.0 ECU_ADDRESS 0x4000259c BYTE_ORDER MSB_FIRST /end MEASUREMENT
/begin COMPU_METHOD CU_MPL_BOOT_VER_MAJOR "Conversion method for mpl_boot_ver_major" RAT_FUNC "%10.0" "(not defined)" COEFFS 0.000000 1.000000 0.000000 0.000000 0.000000 1.000000 /end COMPU_METHOD
/* Scalar measurable for DDE 'mpl_boot_ver_minor'. */
/begin MEASUREMENT mpl_boot_ver_minor "Boot minor version number" UWORD CU_MPL_BOOT_VER_MINOR 1 100 0.0 65535.0 ECU_ADDRESS 0x4000259e BYTE_ORDER MSB_FIRST /end MEASUREMENT
/begin COMPU_METHOD CU_MPL_BOOT_VER_MINOR "Conversion method for mpl_boot_ver_minor" RAT_FUNC "%10.0" "(not defined)" COEFFS 0.000000 1.000000 0.000000 0.000000 0.000000 1.000000 /end COMPU_METHOD
/* Scalar measurable for DDE 'mpl_boot_ver_sub'. */
/begin MEASUREMENT mpl_boot_ver_sub "Boot sub minor version number" UWORD CU_MPL_BOOT_VER_SUB 1 100 0.0 65535.0 ECU_ADDRESS 0x400025a0 BYTE_ORDER MSB_FIRST /end MEASUREMENT
/begin COMPU_METHOD CU_MPL_BOOT_VER_SUB "Conversion method for mpl_boot_ver_sub" RAT_FUNC "%10.0" "(not defined)" COEFFS 0.000000 1.000000 0.000000 0.000000 0.000000 1.000000 /end COMPU_METHOD
/* Scalar measurable for DDE 'mpl_cpu_loaded'. */
/begin MEASUREMENT mpl_cpu_loaded "CPU loading each 50ms" UBYTE CU_MPL_CPU_LOADED 1 100 0.0 255.0 ECU_ADDRESS 0x40002594 BYTE_ORDER MSB_FIRST /end MEASUREMENT
/begin COMPU_METHOD CU_MPL_CPU_LOADED "Conversion method for mpl_cpu_loaded" RAT_FUNC "%10.0" "%" COEFFS 0.000000 1.000000 0.000000 0.000000 0.000000 1.000000 /end COMPU_METHOD
/* Scalar measurable for DDE 'mpl_cpu_loaded_1000ms'. */
/begin MEASUREMENT mpl_cpu_loaded_1000ms "CPU loading each second" UBYTE CU_MPL_CPU_LOADED_1000MS 1 100 0.0 255.0 ECU_ADDRESS 0x40002595 BYTE_ORDER MSB_FIRST /end MEASUREMENT
/begin COMPU_METHOD CU_MPL_CPU_LOADED_1000MS "Conversion method for mpl_cpu_loaded_1000ms" RAT_FUNC "%10.0" "%" COEFFS 0.000000 1.000000 0.000000 0.000000 0.000000 1.000000 /end COMPU_METHOD
/* Scalar measurable for DDE 'mpl_cpu_loaded_50ms'. */
/begin MEASUREMENT mpl_cpu_loaded_50ms "CPU loading each 50ms" UBYTE CU_MPL_CPU_LOADED_50MS 1 100 0.0 255.0 ECU_ADDRESS 0x40002594 BYTE_ORDER MSB_FIRST /end MEASUREMENT
/begin COMPU_METHOD CU_MPL_CPU_LOADED_50MS "Conversion method for mpl_cpu_loaded_50ms" RAT_FUNC "%10.0" "%" COEFFS 0.000000 1.000000 0.000000 0.000000 0.000000 1.000000 /end COMPU_METHOD
/* Scalar measurable for DDE 'mpl_ecc_flash_address'. */
/begin MEASUREMENT mpl_ecc_flash_address "Address of last Flash non-correctable ECC error, zero if no error has occurred." ULONG CU_MPL_ECC_FLASH_ADDRESS 1 100 0.0 4294967295.0 ECU_ADDRESS 0x4000255c BYTE_ORDER MSB_FIRST /end MEASUREMENT
/begin COMPU_METHOD CU_MPL_ECC_FLASH_ADDRESS "Conversion method for mpl_ecc_flash_address" RAT_FUNC "%10.0" "addr" COEFFS 0.000000 1.000000 0.000000 0.000000 0.000000 1.000000 /end COMPU_METHOD
/* Scalar measurable for DDE 'mpl_ecc_ram_address'. */
/begin MEASUREMENT mpl_ecc_ram_address "Address of last RAM non-correctable ECC error, zero if no error has occurred." ULONG CU_MPL_ECC_RAM_ADDRESS 1 100 0.0 4294967295.0 ECU_ADDRESS 0x40002558 BYTE_ORDER MSB_FIRST /end MEASUREMENT
/begin COMPU_METHOD CU_MPL_ECC_RAM_ADDRESS "Conversion method for mpl_ecc_ram_address" RAT_FUNC "%10.0" "addr" COEFFS 0.000000 1.000000 0.000000 0.000000 0.000000 1.000000 /end COMPU_METHOD
/* Scalar measurable for DDE 'mpl_flp_div_by_zero'. */
/begin MEASUREMENT mpl_flp_div_by_zero "Set if FLP division by zero has occurred since the last reset, clear otherwise." UBYTE CU_MPL_FLP_DIV_BY_ZERO 1 100 0.0 255.0 ECU_ADDRESS 0x40002762 BYTE_ORDER MSB_FIRST /end MEASUREMENT
/begin COMPU_METHOD CU_MPL_FLP_DIV_BY_ZERO "Conversion method for mpl_flp_div_by_zero" RAT_FUNC "%10.0" "flag" COEFFS 0.000000 1.000000 0.000000 0.000000 0.000000 1.000000 /end COMPU_METHOD
/* Scalar measurable for DDE 'mpl_flp_inexact'. */
/begin MEASUREMENT mpl_flp_inexact "Set if an inexact FLP result has occurred since the last reset, clear otherwise." UBYTE CU_MPL_FLP_INEXACT 1 100 0.0 255.0 ECU_ADDRESS 0x40002763 BYTE_ORDER MSB_FIRST /end MEASUREMENT
/begin COMPU_METHOD CU_MPL_FLP_INEXACT "Conversion method for mpl_flp_inexact" RAT_FUNC "%10.0" "flag" COEFFS 0.000000 1.000000 0.000000 0.000000 0.000000 1.000000 /end COMPU_METHOD
/* Scalar measurable for DDE 'mpl_flp_invalid'. */
/begin MEASUREMENT mpl_flp_invalid "Set if an invalid FLP result has occurred since the last reset, clear otherwise." UBYTE CU_MPL_FLP_INVALID 1 100 0.0 255.0 ECU_ADDRESS 0x40002764 BYTE_ORDER MSB_FIRST /end MEASUREMENT
/begin COMPU_METHOD CU_MPL_FLP_INVALID "Conversion method for mpl_flp_invalid" RAT_FUNC "%10.0" "flag" COEFFS 0.000000 1.000000 0.000000 0.000000 0.000000 1.000000 /end COMPU_METHOD
/* Scalar measurable for DDE 'mpl_flp_overflow'. */
/begin MEASUREMENT mpl_flp_overflow "Set if FLP overflow has occurred since the last reset, clear otherwise." UBYTE CU_MPL_FLP_OVERFLOW 1 100 0.0 255.0 ECU_ADDRESS 0x40002760 BYTE_ORDER MSB_FIRST /end MEASUREMENT
/begin COMPU_METHOD CU_MPL_FLP_OVERFLOW "Conversion method for mpl_flp_overflow" RAT_FUNC "%10.0" "flag" COEFFS 0.000000 1.000000 0.000000 0.000000 0.000000 1.000000 /end COMPU_METHOD
/* Scalar measurable for DDE 'mpl_flp_underflow'. */
/begin MEASUREMENT mpl_flp_underflow "Set if FLP underflow has occurred since the last reset, clear otherwise." UBYTE CU_MPL_FLP_UNDERFLOW 1 100 0.0 255.0 ECU_ADDRESS 0x40002761 BYTE_ORDER MSB_FIRST /end MEASUREMENT
/begin COMPU_METHOD CU_MPL_FLP_UNDERFLOW "Conversion method for mpl_flp_underflow" RAT_FUNC "%10.0" "flag" COEFFS 0.000000 1.000000 0.000000 0.000000 0.000000 1.000000 /end COMPU_METHOD
/* Scalar measurable for DDE 'mpl_max_cpu_loaded'. */
/begin MEASUREMENT mpl_max_cpu_loaded "Maximum CPU loading seen since startup" UBYTE CU_MPL_MAX_CPU_LOADED 1 100 0.0 255.0 ECU_ADDRESS 0x40002598 BYTE_ORDER MSB_FIRST /end MEASUREMENT
/begin COMPU_METHOD CU_MPL_MAX_CPU_LOADED "Conversion method for mpl_max_cpu_loaded" RAT_FUNC "%10.0" "%" COEFFS 0.000000 1.000000 0.000000 0.000000 0.000000 1.000000 /end COMPU_METHOD
/* Scalar measurable for DDE 'mpl_max_cpu_loaded_1000ms'. */
/begin MEASUREMENT mpl_max_cpu_loaded_1000ms "Maximum CPU loading seen since startup" UBYTE CU_MPL_MAX_CPU_LOADED_1000MS 1 100 0.0 255.0 ECU_ADDRESS 0x40002599 BYTE_ORDER MSB_FIRST /end MEASUREMENT
/begin COMPU_METHOD CU_MPL_MAX_CPU_LOADED_1000MS "Conversion method for mpl_max_cpu_loaded_1000ms" RAT_FUNC "%10.0" "%" COEFFS 0.000000 1.000000 0.000000 0.000000 0.000000 1.000000 /end COMPU_METHOD
/* Scalar measurable for DDE 'mpl_max_cpu_loaded_50ms'. */
/begin MEASUREMENT mpl_max_cpu_loaded_50ms "Maximum CPU loading seen since startup" UBYTE CU_MPL_MAX_CPU_LOADED_50MS 1 100 0.0 255.0 ECU_ADDRESS 0x40002598 BYTE_ORDER MSB_FIRST /end MEASUREMENT
/begin COMPU_METHOD CU_MPL_MAX_CPU_LOADED_50MS "Conversion method for mpl_max_cpu_loaded_50ms" RAT_FUNC "%10.0" "%" COEFFS 0.000000 1.000000 0.000000 0.000000 0.000000 1.000000 /end COMPU_METHOD
/* Scalar measurable for DDE 'mpl_max_used_stack'. */
/begin MEASUREMENT mpl_max_used_stack "Amount of stack used during runtime so far." ULONG CU_MPL_MAX_USED_STACK 1 100 0.0 4294967295.0 ECU_ADDRESS 0x400025fc BYTE_ORDER MSB_FIRST /end MEASUREMENT
/begin COMPU_METHOD CU_MPL_MAX_USED_STACK "Conversion method for mpl_max_used_stack" RAT_FUNC "%10.0" "bytes" COEFFS 0.000000 1.000000 0.000000 0.000000 0.000000 1.000000 /end COMPU_METHOD
/* Scalar measurable for DDE 'mpl_mtt_pan_task'. */
/begin MEASUREMENT mpl_mtt_pan_task "Duration of library task: pan_task" ULONG CU_MPL_MTT_PAN_TASK 1 100 0.0 4294967295.0 ECU_ADDRESS 0x40005ab0 BYTE_ORDER MSB_FIRST /end MEASUREMENT
/begin COMPU_METHOD CU_MPL_MTT_PAN_TASK "Conversion method for mpl_mtt_pan_task" RAT_FUNC "%10.0" "microseconds" COEFFS 0.000000 80.000000 0.000000 0.000000 0.000000 1.000000 /end COMPU_METHOD
/* Scalar measurable for DDE 'mpl_mtt_pcp_client'. */
/begin MEASUREMENT mpl_mtt_pcp_client "Duration of library task: pcp_client" ULONG CU_MPL_MTT_PCP_CLIENT 1 100 0.0 4294967295.0 ECU_ADDRESS 0x40005af0 BYTE_ORDER MSB_FIRST /end MEASUREMENT
/begin COMPU_METHOD CU_MPL_MTT_PCP_CLIENT "Conversion method for mpl_mtt_pcp_client" RAT_FUNC "%10.0" "microseconds" COEFFS 0.000000 80.000000 0.000000 0.000000 0.000000 1.000000 /end COMPU_METHOD
/* Scalar measurable for DDE 'mpl_mtt_pcx_can_callback'. */
/begin MEASUREMENT mpl_mtt_pcx_can_callback "Duration of library task: pcx_can_callback" ULONG CU_MPL_MTT_PCX_CAN_CALLBACK 1 100 0.0 4294967295.0 ECU_ADDRESS 0x40005abc BYTE_ORDER MSB_FIRST /end MEASUREMENT
/begin COMPU_METHOD CU_MPL_MTT_PCX_CAN_CALLBACK "Conversion method for mpl_mtt_pcx_can_callback" RAT_FUNC "%10.0" "microseconds" COEFFS 0.000000 80.000000 0.000000 0.000000 0.000000 1.000000 /end COMPU_METHOD
/* Scalar measurable for DDE 'mpl_mtt_pcx_periodic'. */
/begin MEASUREMENT mpl_mtt_pcx_periodic "Duration of library task: pcx_periodic" ULONG CU_MPL_MTT_PCX_PERIODIC 1 100 0.0 4294967295.0 ECU_ADDRESS 0x40005ae0 BYTE_ORDER MSB_FIRST /end MEASUREMENT
/begin COMPU_METHOD CU_MPL_MTT_PCX_PERIODIC "Conversion method for mpl_mtt_pcx_periodic" RAT_FUNC "%10.0" "microseconds" COEFFS 0.000000 80.000000 0.000000 0.000000 0.000000 1.000000 /end COMPU_METHOD
/* Scalar measurable for DDE 'mpl_mtt_pcx_qemptier'. */
/begin MEASUREMENT mpl_mtt_pcx_qemptier "Duration of library task: pcx_qemptier" ULONG CU_MPL_MTT_PCX_QEMPTIER 1 100 0.0 4294967295.0 ECU_ADDRESS 0x40005ae4 BYTE_ORDER MSB_FIRST /end MEASUREMENT
/begin COMPU_METHOD CU_MPL_MTT_PCX_QEMPTIER "Conversion method for mpl_mtt_pcx_qemptier" RAT_FUNC "%10.0" "microseconds" COEFFS 0.000000 80.000000 0.000000 0.000000 0.000000 1.000000 /end COMPU_METHOD
/* Scalar measurable for DDE 'mpl_mtt_pdg_client_task'. */
/begin MEASUREMENT mpl_mtt_pdg_client_task "Duration of library task: pdg_client_task" ULONG CU_MPL_MTT_PDG_CLIENT_TASK 1 100 0.0 4294967295.0 ECU_ADDRESS 0x40005ad0 BYTE_ORDER MSB_FIRST /end MEASUREMENT
/begin COMPU_METHOD CU_MPL_MTT_PDG_CLIENT_TASK "Conversion method for mpl_mtt_pdg_client_task" RAT_FUNC "%10.0" "microseconds" COEFFS 0.000000 80.000000 0.000000 0.000000 0.000000 1.000000 /end COMPU_METHOD
/* Scalar measurable for DDE 'mpl_mtt_pdtc_client_task'. */
/begin MEASUREMENT mpl_mtt_pdtc_client_task "Duration of library task: pdtc_client_task" ULONG CU_MPL_MTT_PDTC_CLIENT_TASK 1 100 0.0 4294967295.0 ECU_ADDRESS 0x40005adc BYTE_ORDER MSB_FIRST /end MEASUREMENT
/begin COMPU_METHOD CU_MPL_MTT_PDTC_CLIENT_TASK "Conversion method for mpl_mtt_pdtc_client_task" RAT_FUNC "%10.0" "microseconds" COEFFS 0.000000 80.000000 0.000000 0.000000 0.000000 1.000000 /end COMPU_METHOD
/* Scalar measurable for DDE 'mpl_mtt_pfc_task'. */
/begin MEASUREMENT mpl_mtt_pfc_task "Duration of library task: pfc_task" ULONG CU_MPL_MTT_PFC_TASK 1 100 0.0 4294967295.0 ECU_ADDRESS 0x40005ab4 BYTE_ORDER MSB_FIRST /end MEASUREMENT
/begin COMPU_METHOD CU_MPL_MTT_PFC_TASK "Conversion method for mpl_mtt_pfc_task" RAT_FUNC "%10.0" "microseconds" COEFFS 0.000000 80.000000 0.000000 0.000000 0.000000 1.000000 /end COMPU_METHOD
/* Scalar measurable for DDE 'mpl_mtt_pff_client'. */
/begin MEASUREMENT mpl_mtt_pff_client "Duration of library task: pff_client" ULONG CU_MPL_MTT_PFF_CLIENT 1 100 0.0 4294967295.0 ECU_ADDRESS 0x40005ac4 BYTE_ORDER MSB_FIRST /end MEASUREMENT
/begin COMPU_METHOD CU_MPL_MTT_PFF_CLIENT "Conversion method for mpl_mtt_pff_client" RAT_FUNC "%10.0" "microseconds" COEFFS 0.000000 80.000000 0.000000 0.000000 0.000000 1.000000 /end COMPU_METHOD
/* Scalar measurable for DDE 'mpl_mtt_pfs_client'. */
/begin MEASUREMENT mpl_mtt_pfs_client "Duration of library task: pfs_client" ULONG CU_MPL_MTT_PFS_CLIENT 1 100 0.0 4294967295.0 ECU_ADDRESS 0x40005ac8 BYTE_ORDER MSB_FIRST /end MEASUREMENT
/begin COMPU_METHOD CU_MPL_MTT_PFS_CLIENT "Conversion method for mpl_mtt_pfs_client" RAT_FUNC "%10.0" "microseconds" COEFFS 0.000000 80.000000 0.000000 0.000000 0.000000 1.000000 /end COMPU_METHOD
/* Scalar measurable for DDE 'mpl_mtt_piso_client_task'. */
/begin MEASUREMENT mpl_mtt_piso_client_task "Duration of library task: piso_client_task" ULONG CU_MPL_MTT_PISO_CLIENT_TASK 1 100 0.0 4294967295.0 ECU_ADDRESS 0x40005acc BYTE_ORDER MSB_FIRST /end MEASUREMENT
/begin COMPU_METHOD CU_MPL_MTT_PISO_CLIENT_TASK "Conversion method for mpl_mtt_piso_client_task" RAT_FUNC "%10.0" "microseconds" COEFFS 0.000000 80.000000 0.000000 0.000000 0.000000 1.000000 /end COMPU_METHOD
/* Scalar measurable for DDE 'mpl_mtt_pj1939_client'. */
/begin MEASUREMENT mpl_mtt_pj1939_client "Duration of library task: pj1939_client" ULONG CU_MPL_MTT_PJ1939_CLIENT 1 100 0.0 4294967295.0 ECU_ADDRESS 0x40005ac0 BYTE_ORDER MSB_FIRST /end MEASUREMENT
/begin COMPU_METHOD CU_MPL_MTT_PJ1939_CLIENT "Conversion method for mpl_mtt_pj1939_client" RAT_FUNC "%10.0" "microseconds" COEFFS 0.000000 80.000000 0.000000 0.000000 0.000000 1.000000 /end COMPU_METHOD
/* Scalar measurable for DDE 'mpl_mtt_psc_watchdog'. */
/begin MEASUREMENT mpl_mtt_psc_watchdog "Duration of library task: psc_watchdog" ULONG CU_MPL_MTT_PSC_WATCHDOG 1 100 0.0 4294967295.0 ECU_ADDRESS 0x40005aec BYTE_ORDER MSB_FIRST /end MEASUREMENT
/begin COMPU_METHOD CU_MPL_MTT_PSC_WATCHDOG "Conversion method for mpl_mtt_psc_watchdog" RAT_FUNC "%10.0" "microseconds" COEFFS 0.000000 80.000000 0.000000 0.000000 0.000000 1.000000 /end COMPU_METHOD
/* Scalar measurable for DDE 'mpl_mtt_psp_periodic'. */
/begin MEASUREMENT mpl_mtt_psp_periodic "Duration of library task: psp_periodic" ULONG CU_MPL_MTT_PSP_PERIODIC 1 100 0.0 4294967295.0 ECU_ADDRESS 0x40005ae8 BYTE_ORDER MSB_FIRST /end MEASUREMENT
/begin COMPU_METHOD CU_MPL_MTT_PSP_PERIODIC "Conversion method for mpl_mtt_psp_periodic" RAT_FUNC "%10.0" "microseconds" COEFFS 0.000000 80.000000 0.000000 0.000000 0.000000 1.000000 /end COMPU_METHOD
/* Scalar measurable for DDE 'mpl_mtt_psp_receive'. */
/begin MEASUREMENT mpl_mtt_psp_receive "Duration of library task: psp_receive" ULONG CU_MPL_MTT_PSP_RECEIVE 1 100 0.0 4294967295.0 ECU_ADDRESS 0x40005ab8 BYTE_ORDER MSB_FIRST /end MEASUREMENT
/begin COMPU_METHOD CU_MPL_MTT_PSP_RECEIVE "Conversion method for mpl_mtt_psp_receive" RAT_FUNC "%10.0" "microseconds" COEFFS 0.000000 80.000000 0.000000 0.000000 0.000000 1.000000 /end COMPU_METHOD
/* Scalar measurable for DDE 'mpl_mtt_pss_task'. */
/begin MEASUREMENT mpl_mtt_pss_task "Duration of library task: pss_task" ULONG CU_MPL_MTT_PSS_TASK 1 100 0.0 4294967295.0 ECU_ADDRESS 0x40005aac BYTE_ORDER MSB_FIRST /end MEASUREMENT
/begin COMPU_METHOD CU_MPL_MTT_PSS_TASK "Conversion method for mpl_mtt_pss_task" RAT_FUNC "%10.0" "microseconds" COEFFS 0.000000 80.000000 0.000000 0.000000 0.000000 1.000000 /end COMPU_METHOD
/* Scalar measurable for DDE 'mpl_mtt_task_1000ms'. */
/begin MEASUREMENT mpl_mtt_task_1000ms "Duration of application task: task_1000ms" ULONG CU_MPL_MTT_TASK_1000MS 1 100 0.0 4294967295.0 ECU_ADDRESS 0x40005ad8 BYTE_ORDER MSB_FIRST /end MEASUREMENT
/begin COMPU_METHOD CU_MPL_MTT_TASK_1000MS "Conversion method for mpl_mtt_task_1000ms" RAT_FUNC "%10.0" "microseconds" COEFFS 0.000000 80.000000 0.000000 0.000000 0.000000 1.000000 /end COMPU_METHOD
/* Scalar measurable for DDE 'mpl_mtt_task_10ms'. */
/begin MEASUREMENT mpl_mtt_task_10ms "Duration of application task: task_10ms" ULONG CU_MPL_MTT_TASK_10MS 1 100 0.0 4294967295.0 ECU_ADDRESS 0x40005ad4 BYTE_ORDER MSB_FIRST /end MEASUREMENT
/begin COMPU_METHOD CU_MPL_MTT_TASK_10MS "Conversion method for mpl_mtt_task_10ms" RAT_FUNC "%10.0" "microseconds" COEFFS 0.000000 80.000000 0.000000 0.000000 0.000000 1.000000 /end COMPU_METHOD
/* Scalar measurable for DDE 'mpl_ovrc_pcp_client'. */
/begin MEASUREMENT mpl_ovrc_pcp_client "Overrun count of library task: pcp_client" UBYTE CU_MPL_OVRC_PCP_CLIENT 1 100 0.0 255.0 ECU_ADDRESS 0x40005a6b BYTE_ORDER MSB_FIRST /end MEASUREMENT
/begin COMPU_METHOD CU_MPL_OVRC_PCP_CLIENT "Conversion method for mpl_ovrc_pcp_client" RAT_FUNC "%10.0" "count" COEFFS 0.000000 1.000000 0.000000 0.000000 0.000000 1.000000 /end COMPU_METHOD
/* Scalar measurable for DDE 'mpl_ovrc_pcx_can_callback'. */
/begin MEASUREMENT mpl_ovrc_pcx_can_callback "Overrun count of library task: pcx_can_callback" UBYTE CU_MPL_OVRC_PCX_CAN_CALLBACK 1 100 0.0 255.0 ECU_ADDRESS 0x40005a5e BYTE_ORDER MSB_FIRST /end MEASUREMENT
/begin COMPU_METHOD CU_MPL_OVRC_PCX_CAN_CALLBACK "Conversion method for mpl_ovrc_pcx_can_callback" RAT_FUNC "%10.0" "count" COEFFS 0.000000 1.000000 0.000000 0.000000 0.000000 1.000000 /end COMPU_METHOD
/* Scalar measurable for DDE 'mpl_ovrc_pcx_periodic'. */
/begin MEASUREMENT mpl_ovrc_pcx_periodic "Overrun count of library task: pcx_periodic" UBYTE CU_MPL_OVRC_PCX_PERIODIC 1 100 0.0 255.0 ECU_ADDRESS 0x40005a67 BYTE_ORDER MSB_FIRST /end MEASUREMENT
/begin COMPU_METHOD CU_MPL_OVRC_PCX_PERIODIC "Conversion method for mpl_ovrc_pcx_periodic" RAT_FUNC "%10.0" "count" COEFFS 0.000000 1.000000 0.000000 0.000000 0.000000 1.000000 /end COMPU_METHOD
/* Scalar measurable for DDE 'mpl_ovrc_pcx_qemptier'. */
/begin MEASUREMENT mpl_ovrc_pcx_qemptier "Overrun count of library task: pcx_qemptier" UBYTE CU_MPL_OVRC_PCX_QEMPTIER 1 100 0.0 255.0 ECU_ADDRESS 0x40005a68 BYTE_ORDER MSB_FIRST /end MEASUREMENT
/begin COMPU_METHOD CU_MPL_OVRC_PCX_QEMPTIER "Conversion method for mpl_ovrc_pcx_qemptier" RAT_FUNC "%10.0" "count" COEFFS 0.000000 1.000000 0.000000 0.000000 0.000000 1.000000 /end COMPU_METHOD
/* Scalar measurable for DDE 'mpl_ovrc_pdg_client_task'. */
/begin MEASUREMENT mpl_ovrc_pdg_client_task "Overrun count of library task: pdg_client_task" UBYTE CU_MPL_OVRC_PDG_CLIENT_TASK 1 100 0.0 255.0 ECU_ADDRESS 0x40005a63 BYTE_ORDER MSB_FIRST /end MEASUREMENT
/begin COMPU_METHOD CU_MPL_OVRC_PDG_CLIENT_TASK "Conversion method for mpl_ovrc_pdg_client_task" RAT_FUNC "%10.0" "count" COEFFS 0.000000 1.000000 0.000000 0.000000 0.000000 1.000000 /end COMPU_METHOD
/* Scalar measurable for DDE 'mpl_ovrc_pdtc_client_task'. */
/begin MEASUREMENT mpl_ovrc_pdtc_client_task "Overrun count of library task: pdtc_client_task" UBYTE CU_MPL_OVRC_PDTC_CLIENT_TASK 1 100 0.0 255.0 ECU_ADDRESS 0x40005a66 BYTE_ORDER MSB_FIRST /end MEASUREMENT
/begin COMPU_METHOD CU_MPL_OVRC_PDTC_CLIENT_TASK "Conversion method for mpl_ovrc_pdtc_client_task" RAT_FUNC "%10.0" "count" COEFFS 0.000000 1.000000 0.000000 0.000000 0.000000 1.000000 /end COMPU_METHOD
/* Scalar measurable for DDE 'mpl_ovrc_pfc_task'. */
/begin MEASUREMENT mpl_ovrc_pfc_task "Overrun count of library task: pfc_task" UBYTE CU_MPL_OVRC_PFC_TASK 1 100 0.0 255.0 ECU_ADDRESS 0x40005a5d BYTE_ORDER MSB_FIRST /end MEASUREMENT
/begin COMPU_METHOD CU_MPL_OVRC_PFC_TASK "Conversion method for mpl_ovrc_pfc_task" RAT_FUNC "%10.0" "count" COEFFS 0.000000 1.000000 0.000000 0.000000 0.000000 1.000000 /end COMPU_METHOD
/* Scalar measurable for DDE 'mpl_ovrc_pff_client'. */
/begin MEASUREMENT mpl_ovrc_pff_client "Overrun count of library task: pff_client" UBYTE CU_MPL_OVRC_PFF_CLIENT 1 100 0.0 255.0 ECU_ADDRESS 0x40005a60 BYTE_ORDER MSB_FIRST /end MEASUREMENT
/begin COMPU_METHOD CU_MPL_OVRC_PFF_CLIENT "Conversion method for mpl_ovrc_pff_client" RAT_FUNC "%10.0" "count" COEFFS 0.000000 1.000000 0.000000 0.000000 0.000000 1.000000 /end COMPU_METHOD
/* Scalar measurable for DDE 'mpl_ovrc_pfs_client'. */
/begin MEASUREMENT mpl_ovrc_pfs_client "Overrun count of library task: pfs_client" UBYTE CU_MPL_OVRC_PFS_CLIENT 1 100 0.0 255.0 ECU_ADDRESS 0x40005a61 BYTE_ORDER MSB_FIRST /end MEASUREMENT
/begin COMPU_METHOD CU_MPL_OVRC_PFS_CLIENT "Conversion method for mpl_ovrc_pfs_client" RAT_FUNC "%10.0" "count" COEFFS 0.000000 1.000000 0.000000 0.000000 0.000000 1.000000 /end COMPU_METHOD
/* Scalar measurable for DDE 'mpl_ovrc_piso_client_task'. */
/begin MEASUREMENT mpl_ovrc_piso_client_task "Overrun count of library task: piso_client_task" UBYTE CU_MPL_OVRC_PISO_CLIENT_TASK 1 100 0.0 255.0 ECU_ADDRESS 0x40005a62 BYTE_ORDER MSB_FIRST /end MEASUREMENT
/begin COMPU_METHOD CU_MPL_OVRC_PISO_CLIENT_TASK "Conversion method for mpl_ovrc_piso_client_task" RAT_FUNC "%10.0" "count" COEFFS 0.000000 1.000000 0.000000 0.000000 0.000000 1.000000 /end COMPU_METHOD
/* Scalar measurable for DDE 'mpl_ovrc_pj1939_client'. */
/begin MEASUREMENT mpl_ovrc_pj1939_client "Overrun count of library task: pj1939_client" UBYTE CU_MPL_OVRC_PJ1939_CLIENT 1 100 0.0 255.0 ECU_ADDRESS 0x40005a5f BYTE_ORDER MSB_FIRST /end MEASUREMENT
/begin COMPU_METHOD CU_MPL_OVRC_PJ1939_CLIENT "Conversion method for mpl_ovrc_pj1939_client" RAT_FUNC "%10.0" "count" COEFFS 0.000000 1.000000 0.000000 0.000000 0.000000 1.000000 /end COMPU_METHOD
/* Scalar measurable for DDE 'mpl_ovrc_psc_watchdog'. */
/begin MEASUREMENT mpl_ovrc_psc_watchdog "Overrun count of library task: psc_watchdog" UBYTE CU_MPL_OVRC_PSC_WATCHDOG 1 100 0.0 255.0 ECU_ADDRESS 0x40005a6a BYTE_ORDER MSB_FIRST /end MEASUREMENT
/begin COMPU_METHOD CU_MPL_OVRC_PSC_WATCHDOG "Conversion method for mpl_ovrc_psc_watchdog" RAT_FUNC "%10.0" "count" COEFFS 0.000000 1.000000 0.000000 0.000000 0.000000 1.000000 /end COMPU_METHOD
/* Scalar measurable for DDE 'mpl_ovrc_psp_periodic'. */
/begin MEASUREMENT mpl_ovrc_psp_periodic "Overrun count of library task: psp_periodic" UBYTE CU_MPL_OVRC_PSP_PERIODIC 1 100 0.0 255.0 ECU_ADDRESS 0x40005a69 BYTE_ORDER MSB_FIRST /end MEASUREMENT
/begin COMPU_METHOD CU_MPL_OVRC_PSP_PERIODIC "Conversion method for mpl_ovrc_psp_periodic" RAT_FUNC "%10.0" "count" COEFFS 0.000000 1.000000 0.000000 0.000000 0.000000 1.000000 /end COMPU_METHOD
/* Scalar measurable for DDE 'mpl_ovrc_pss_task'. */
/begin MEASUREMENT mpl_ovrc_pss_task "Overrun count of library task: pss_task" UBYTE CU_MPL_OVRC_PSS_TASK 1 100 0.0 255.0 ECU_ADDRESS 0x40005a5c BYTE_ORDER MSB_FIRST /end MEASUREMENT
/begin COMPU_METHOD CU_MPL_OVRC_PSS_TASK "Conversion method for mpl_ovrc_pss_task" RAT_FUNC "%10.0" "count" COEFFS 0.000000 1.000000 0.000000 0.000000 0.000000 1.000000 /end COMPU_METHOD
/* Scalar measurable for DDE 'mpl_ovrc_task_1000ms'. */
/begin MEASUREMENT mpl_ovrc_task_1000ms "Overrun count of application task: task_1000ms" UBYTE CU_MPL_OVRC_TASK_1000MS 1 100 0.0 255.0 ECU_ADDRESS 0x40005a65 BYTE_ORDER MSB_FIRST /end MEASUREMENT
/begin COMPU_METHOD CU_MPL_OVRC_TASK_1000MS "Conversion method for mpl_ovrc_task_1000ms" RAT_FUNC "%10.0" "count" COEFFS 0.000000 1.000000 0.000000 0.000000 0.000000 1.000000 /end COMPU_METHOD
/* Scalar measurable for DDE 'mpl_ovrc_task_10ms'. */
/begin MEASUREMENT mpl_ovrc_task_10ms "Overrun count of application task: task_10ms" UBYTE CU_MPL_OVRC_TASK_10MS 1 100 0.0 255.0 ECU_ADDRESS 0x40005a64 BYTE_ORDER MSB_FIRST /end MEASUREMENT
/begin COMPU_METHOD CU_MPL_OVRC_TASK_10MS "Conversion method for mpl_ovrc_task_10ms" RAT_FUNC "%10.0" "count" COEFFS 0.000000 1.000000 0.000000 0.000000 0.000000 1.000000 /end COMPU_METHOD
/* Scalar measurable for DDE 'mpl_plat_build_day'. */
/begin MEASUREMENT mpl_plat_build_day "Platform build day" UWORD CU_MPL_PLAT_BUILD_DAY 1 100 0.0 65535.0 ECU_ADDRESS 0x400025cc BYTE_ORDER MSB_FIRST /end MEASUREMENT
/begin COMPU_METHOD CU_MPL_PLAT_BUILD_DAY "Conversion method for mpl_plat_build_day" RAT_FUNC "%10.0" "(not defined)" COEFFS 0.000000 1.000000 0.000000 0.000000 0.000000 1.000000 /end COMPU_METHOD
/* Scalar measurable for DDE 'mpl_plat_build_month'. */
/begin MEASUREMENT mpl_plat_build_month "Platform build month" UWORD CU_MPL_PLAT_BUILD_MONTH 1 100 0.0 65535.0 ECU_ADDRESS 0x400025ce BYTE_ORDER MSB_FIRST /end MEASUREMENT
/begin COMPU_METHOD CU_MPL_PLAT_BUILD_MONTH "Conversion method for mpl_plat_build_month" RAT_FUNC "%10.0" "(not defined)" COEFFS 0.000000 1.000000 0.000000 0.000000 0.000000 1.000000 /end COMPU_METHOD
/* Scalar measurable for DDE 'mpl_plat_build_year'. */
/begin MEASUREMENT mpl_plat_build_year "Platform build year" UWORD CU_MPL_PLAT_BUILD_YEAR 1 100 0.0 65535.0 ECU_ADDRESS 0x400025d0 BYTE_ORDER MSB_FIRST /end MEASUREMENT
/begin COMPU_METHOD CU_MPL_PLAT_BUILD_YEAR "Conversion method for mpl_plat_build_year" RAT_FUNC "%10.0" "(not defined)" COEFFS 0.000000 1.000000 0.000000 0.000000 0.000000 1.000000 /end COMPU_METHOD
/* Scalar measurable for DDE 'mpl_plat_part_num_group'. */
/begin MEASUREMENT mpl_plat_part_num_group "Platform Group ID number of the part number" UBYTE CU_MPL_PLAT_PART_NUM_GROUP 1 100 0.0 255.0 ECU_ADDRESS 0x400025d2 BYTE_ORDER MSB_FIRST /end MEASUREMENT
/begin COMPU_METHOD CU_MPL_PLAT_PART_NUM_GROUP "Conversion method for mpl_plat_part_num_group" RAT_FUNC "%10.0" "(not defined)" COEFFS 0.000000 1.000000 0.000000 0.000000 0.000000 1.000000 /end COMPU_METHOD
/* Scalar measurable for DDE 'mpl_plat_part_num_id'. */
/begin MEASUREMENT mpl_plat_part_num_id "Platform Part ID of the part number" ULONG CU_MPL_PLAT_PART_NUM_ID 1 100 0.0 4294967295.0 ECU_ADDRESS 0x400025d4 BYTE_ORDER MSB_FIRST /end MEASUREMENT
/begin COMPU_METHOD CU_MPL_PLAT_PART_NUM_ID "Conversion method for mpl_plat_part_num_id" RAT_FUNC "%10.0" "(not defined)" COEFFS 0.000000 1.000000 0.000000 0.000000 0.000000 1.000000 /end COMPU_METHOD
/* Scalar measurable for DDE 'mpl_plat_part_num_issue'. */
/begin MEASUREMENT mpl_plat_part_num_issue "Platform Issue number of the part number" UWORD CU_MPL_PLAT_PART_NUM_ISSUE 1 100 0.0 65535.0 ECU_ADDRESS 0x400025d8 BYTE_ORDER MSB_FIRST /end MEASUREMENT
/begin COMPU_METHOD CU_MPL_PLAT_PART_NUM_ISSUE "Conversion method for mpl_plat_part_num_issue" RAT_FUNC "%10.0" "(not defined)" COEFFS 0.000000 1.000000 0.000000 0.000000 0.000000 1.000000 /end COMPU_METHOD
/* Scalar measurable for DDE 'mpl_plat_part_num_letter'. */
/begin MEASUREMENT mpl_plat_part_num_letter "Platform Group Letter of the part number" UBYTE CU_MPL_PLAT_PART_NUM_LETTER 1 100 0.0 255.0 ECU_ADDRESS 0x400025d3 BYTE_ORDER MSB_FIRST /end MEASUREMENT
/begin COMPU_METHOD CU_MPL_PLAT_PART_NUM_LETTER "Conversion method for mpl_plat_part_num_letter" RAT_FUNC "%10.0" "(not defined)" COEFFS 0.000000 1.000000 0.000000 0.000000 0.000000 1.000000 /end COMPU_METHOD
/* Scalar measurable for DDE 'mpl_plat_ver_major'. */
/begin MEASUREMENT mpl_plat_ver_major "Platform major version number" UWORD CU_MPL_PLAT_VER_MAJOR 1 100 0.0 65535.0 ECU_ADDRESS 0x400025c6 BYTE_ORDER MSB_FIRST /end MEASUREMENT
/begin COMPU_METHOD CU_MPL_PLAT_VER_MAJOR "Conversion method for mpl_plat_ver_major" RAT_FUNC "%10.0" "(not defined)" COEFFS 0.000000 1.000000 0.000000 0.000000 0.000000 1.000000 /end COMPU_METHOD
/* Scalar measurable for DDE 'mpl_plat_ver_minor'. */
/begin MEASUREMENT mpl_plat_ver_minor "Platform minor version number" UWORD CU_MPL_PLAT_VER_MINOR 1 100 0.0 65535.0 ECU_ADDRESS 0x400025c8 BYTE_ORDER MSB_FIRST /end MEASUREMENT
/begin COMPU_METHOD CU_MPL_PLAT_VER_MINOR "Conversion method for mpl_plat_ver_minor" RAT_FUNC "%10.0" "(not defined)" COEFFS 0.000000 1.000000 0.000000 0.000000 0.000000 1.000000 /end COMPU_METHOD
/* Scalar measurable for DDE 'mpl_plat_ver_sub'. */
/begin MEASUREMENT mpl_plat_ver_sub "Platform sub minor version number" UWORD CU_MPL_PLAT_VER_SUB 1 100 0.0 65535.0 ECU_ADDRESS 0x400025ca BYTE_ORDER MSB_FIRST /end MEASUREMENT
/begin COMPU_METHOD CU_MPL_PLAT_VER_SUB "Conversion method for mpl_plat_ver_sub" RAT_FUNC "%10.0" "(not defined)" COEFFS 0.000000 1.000000 0.000000 0.000000 0.000000 1.000000 /end COMPU_METHOD
/* Scalar measurable for DDE 'mpl_prg_build_day'. */
/begin MEASUREMENT mpl_prg_build_day "PRG build day" UWORD CU_MPL_PRG_BUILD_DAY 1 100 0.0 65535.0 ECU_ADDRESS 0x400025b8 BYTE_ORDER MSB_FIRST /end MEASUREMENT
/begin COMPU_METHOD CU_MPL_PRG_BUILD_DAY "Conversion method for mpl_prg_build_day" RAT_FUNC "%10.0" "(not defined)" COEFFS 0.000000 1.000000 0.000000 0.000000 0.000000 1.000000 /end COMPU_METHOD
/* Scalar measurable for DDE 'mpl_prg_build_month'. */
/begin MEASUREMENT mpl_prg_build_month "PRG build month" UWORD CU_MPL_PRG_BUILD_MONTH 1 100 0.0 65535.0 ECU_ADDRESS 0x400025ba BYTE_ORDER MSB_FIRST /end MEASUREMENT
/begin COMPU_METHOD CU_MPL_PRG_BUILD_MONTH "Conversion method for mpl_prg_build_month" RAT_FUNC "%10.0" "(not defined)" COEFFS 0.000000 1.000000 0.000000 0.000000 0.000000 1.000000 /end COMPU_METHOD
/* Scalar measurable for DDE 'mpl_prg_build_year'. */
/begin MEASUREMENT mpl_prg_build_year "PRG build year" UWORD CU_MPL_PRG_BUILD_YEAR 1 100 0.0 65535.0 ECU_ADDRESS 0x400025bc BYTE_ORDER MSB_FIRST /end MEASUREMENT
/begin COMPU_METHOD CU_MPL_PRG_BUILD_YEAR "Conversion method for mpl_prg_build_year" RAT_FUNC "%10.0" "(not defined)" COEFFS 0.000000 1.000000 0.000000 0.000000 0.000000 1.000000 /end COMPU_METHOD
/* Scalar measurable for DDE 'mpl_prg_part_num_group'. */
/begin MEASUREMENT mpl_prg_part_num_group "PRG Group ID number in the part number" UBYTE CU_MPL_PRG_PART_NUM_GROUP 1 100 0.0 255.0 ECU_ADDRESS 0x400025be BYTE_ORDER MSB_FIRST /end MEASUREMENT
/begin COMPU_METHOD CU_MPL_PRG_PART_NUM_GROUP "Conversion method for mpl_prg_part_num_group" RAT_FUNC "%10.0" "(not defined)" COEFFS 0.000000 1.000000 0.000000 0.000000 0.000000 1.000000 /end COMPU_METHOD
/* Scalar measurable for DDE 'mpl_prg_part_num_id'. */
/begin MEASUREMENT mpl_prg_part_num_id "PRG Part ID in the part number" ULONG CU_MPL_PRG_PART_NUM_ID 1 100 0.0 4294967295.0 ECU_ADDRESS 0x400025c0 BYTE_ORDER MSB_FIRST /end MEASUREMENT
/begin COMPU_METHOD CU_MPL_PRG_PART_NUM_ID "Conversion method for mpl_prg_part_num_id" RAT_FUNC "%10.0" "(not defined)" COEFFS 0.000000 1.000000 0.000000 0.000000 0.000000 1.000000 /end COMPU_METHOD
/* Scalar measurable for DDE 'mpl_prg_part_num_issue'. */
/begin MEASUREMENT mpl_prg_part_num_issue "PRG Issue number in the part number" UWORD CU_MPL_PRG_PART_NUM_ISSUE 1 100 0.0 65535.0 ECU_ADDRESS 0x400025c4 BYTE_ORDER MSB_FIRST /end MEASUREMENT
/begin COMPU_METHOD CU_MPL_PRG_PART_NUM_ISSUE "Conversion method for mpl_prg_part_num_issue" RAT_FUNC "%10.0" "(not defined)" COEFFS 0.000000 1.000000 0.000000 0.000000 0.000000 1.000000 /end COMPU_METHOD
/* Scalar measurable for DDE 'mpl_prg_part_num_letter'. */
/begin MEASUREMENT mpl_prg_part_num_letter "PRG Group Letter in the part number" UBYTE CU_MPL_PRG_PART_NUM_LETTER 1 100 0.0 255.0 ECU_ADDRESS 0x400025bf BYTE_ORDER MSB_FIRST /end MEASUREMENT
/begin COMPU_METHOD CU_MPL_PRG_PART_NUM_LETTER "Conversion method for mpl_prg_part_num_letter" RAT_FUNC "%10.0" "(not defined)" COEFFS 0.000000 1.000000 0.000000 0.000000 0.000000 1.000000 /end COMPU_METHOD
/* Scalar measurable for DDE 'mpl_prg_ver_major'. */
/begin MEASUREMENT mpl_prg_ver_major "PRG major version number" UWORD CU_MPL_PRG_VER_MAJOR 1 100 0.0 65535.0 ECU_ADDRESS 0x400025b2 BYTE_ORDER MSB_FIRST /end MEASUREMENT
/begin COMPU_METHOD CU_MPL_PRG_VER_MAJOR "Conversion method for mpl_prg_ver_major" RAT_FUNC "%10.0" "(not defined)" COEFFS 0.000000 1.000000 0.000000 0.000000 0.000000 1.000000 /end COMPU_METHOD
/* Scalar measurable for DDE 'mpl_prg_ver_minor'. */
/begin MEASUREMENT mpl_prg_ver_minor "PRG minor version number" UWORD CU_MPL_PRG_VER_MINOR 1 100 0.0 65535.0 ECU_ADDRESS 0x400025b4 BYTE_ORDER MSB_FIRST /end MEASUREMENT
/begin COMPU_METHOD CU_MPL_PRG_VER_MINOR "Conversion method for mpl_prg_ver_minor" RAT_FUNC "%10.0" "(not defined)" COEFFS 0.000000 1.000000 0.000000 0.000000 0.000000 1.000000 /end COMPU_METHOD
/* Scalar measurable for DDE 'mpl_prg_ver_sub'. */
/begin MEASUREMENT mpl_prg_ver_sub "PRG sub minor version number" UWORD CU_MPL_PRG_VER_SUB 1 100 0.0 65535.0 ECU_ADDRESS 0x400025b6 BYTE_ORDER MSB_FIRST /end MEASUREMENT
/begin COMPU_METHOD CU_MPL_PRG_VER_SUB "Conversion method for mpl_prg_ver_sub" RAT_FUNC "%10.0" "(not defined)" COEFFS 0.000000 1.000000 0.000000 0.000000 0.000000 1.000000 /end COMPU_METHOD
/* Scalar measurable for DDE 'mpl_reset_count'. */
/begin MEASUREMENT mpl_reset_count "Number of resets since power-up." ULONG CU_MPL_RESET_COUNT 1 100 0.0 4294967295.0 ECU_ADDRESS 0x400025f0 BYTE_ORDER MSB_FIRST /end MEASUREMENT
/begin COMPU_METHOD CU_MPL_RESET_COUNT "Conversion method for mpl_reset_count" RAT_FUNC "%10.0" "events" COEFFS 0.000000 1.000000 0.000000 0.000000 0.000000 1.000000 /end COMPU_METHOD
/* Scalar measurable for DDE 'mpl_run_time'. */
/begin MEASUREMENT mpl_run_time "Time since startup" ULONG CU_MPL_RUN_TIME 1 100 0.0 4294967295.0 ECU_ADDRESS 0x400025f8 BYTE_ORDER MSB_FIRST /end MEASUREMENT
/begin COMPU_METHOD CU_MPL_RUN_TIME "Conversion method for mpl_run_time" RAT_FUNC "%10.0" "seconds" COEFFS 0.000000 1.000000 0.000000 0.000000 0.000000 1.000000 /end COMPU_METHOD
/* Scalar measurable for DDE 'mpl_tt_pan_task'. */
/begin MEASUREMENT mpl_tt_pan_task "Duration of library task: pan_task" ULONG CU_MPL_TT_PAN_TASK 1 100 0.0 4294967295.0 ECU_ADDRESS 0x40005afc BYTE_ORDER MSB_FIRST /end MEASUREMENT
/begin COMPU_METHOD CU_MPL_TT_PAN_TASK "Conversion method for mpl_tt_pan_task" RAT_FUNC "%10.0" "microseconds" COEFFS 0.000000 80.000000 0.000000 0.000000 0.000000 1.000000 /end COMPU_METHOD
/* Scalar measurable for DDE 'mpl_tt_pcp_client'. */
/begin MEASUREMENT mpl_tt_pcp_client "Duration of library task: pcp_client" ULONG CU_MPL_TT_PCP_CLIENT 1 100 0.0 4294967295.0 ECU_ADDRESS 0x40005b3c BYTE_ORDER MSB_FIRST /end MEASUREMENT
/begin COMPU_METHOD CU_MPL_TT_PCP_CLIENT "Conversion method for mpl_tt_pcp_client" RAT_FUNC "%10.0" "microseconds" COEFFS 0.000000 80.000000 0.000000 0.000000 0.000000 1.000000 /end COMPU_METHOD
/* Scalar measurable for DDE 'mpl_tt_pcx_can_callback'. */
/begin MEASUREMENT mpl_tt_pcx_can_callback "Duration of library task: pcx_can_callback" ULONG CU_MPL_TT_PCX_CAN_CALLBACK 1 100 0.0 4294967295.0 ECU_ADDRESS 0x40005b08 BYTE_ORDER MSB_FIRST /end MEASUREMENT
/begin COMPU_METHOD CU_MPL_TT_PCX_CAN_CALLBACK "Conversion method for mpl_tt_pcx_can_callback" RAT_FUNC "%10.0" "microseconds" COEFFS 0.000000 80.000000 0.000000 0.000000 0.000000 1.000000 /end COMPU_METHOD
/* Scalar measurable for DDE 'mpl_tt_pcx_periodic'. */
/begin MEASUREMENT mpl_tt_pcx_periodic "Duration of library task: pcx_periodic" ULONG CU_MPL_TT_PCX_PERIODIC 1 100 0.0 4294967295.0 ECU_ADDRESS 0x40005b2c BYTE_ORDER MSB_FIRST /end MEASUREMENT
/begin COMPU_METHOD CU_MPL_TT_PCX_PERIODIC "Conversion method for mpl_tt_pcx_periodic" RAT_FUNC "%10.0" "microseconds" COEFFS 0.000000 80.000000 0.000000 0.000000 0.000000 1.000000 /end COMPU_METHOD
/* Scalar measurable for DDE 'mpl_tt_pcx_qemptier'. */
/begin MEASUREMENT mpl_tt_pcx_qemptier "Duration of library task: pcx_qemptier" ULONG CU_MPL_TT_PCX_QEMPTIER 1 100 0.0 4294967295.0 ECU_ADDRESS 0x40005b30 BYTE_ORDER MSB_FIRST /end MEASUREMENT
/begin COMPU_METHOD CU_MPL_TT_PCX_QEMPTIER "Conversion method for mpl_tt_pcx_qemptier" RAT_FUNC "%10.0" "microseconds" COEFFS 0.000000 80.000000 0.000000 0.000000 0.000000 1.000000 /end COMPU_METHOD
/* Scalar measurable for DDE 'mpl_tt_pdg_client_task'. */
/begin MEASUREMENT mpl_tt_pdg_client_task "Duration of library task: pdg_client_task" ULONG CU_MPL_TT_PDG_CLIENT_TASK 1 100 0.0 4294967295.0 ECU_ADDRESS 0x40005b1c BYTE_ORDER MSB_FIRST /end MEASUREMENT
/begin COMPU_METHOD CU_MPL_TT_PDG_CLIENT_TASK "Conversion method for mpl_tt_pdg_client_task" RAT_FUNC "%10.0" "microseconds" COEFFS 0.000000 80.000000 0.000000 0.000000 0.000000 1.000000 /end COMPU_METHOD
/* Scalar measurable for DDE 'mpl_tt_pdtc_client_task'. */
/begin MEASUREMENT mpl_tt_pdtc_client_task "Duration of library task: pdtc_client_task" ULONG CU_MPL_TT_PDTC_CLIENT_TASK 1 100 0.0 4294967295.0 ECU_ADDRESS 0x40005b28 BYTE_ORDER MSB_FIRST /end MEASUREMENT
/begin COMPU_METHOD CU_MPL_TT_PDTC_CLIENT_TASK "Conversion method for mpl_tt_pdtc_client_task" RAT_FUNC "%10.0" "microseconds" COEFFS 0.000000 80.000000 0.000000 0.000000 0.000000 1.000000 /end COMPU_METHOD
/* Scalar measurable for DDE 'mpl_tt_pfc_task'. */
/begin MEASUREMENT mpl_tt_pfc_task "Duration of library task: pfc_task" ULONG CU_MPL_TT_PFC_TASK 1 100 0.0 4294967295.0 ECU_ADDRESS 0x40005b00 BYTE_ORDER MSB_FIRST /end MEASUREMENT
/begin COMPU_METHOD CU_MPL_TT_PFC_TASK "Conversion method for mpl_tt_pfc_task" RAT_FUNC "%10.0" "microseconds" COEFFS 0.000000 80.000000 0.000000 0.000000 0.000000 1.000000 /end COMPU_METHOD
/* Scalar measurable for DDE 'mpl_tt_pff_client'. */
/begin MEASUREMENT mpl_tt_pff_client "Duration of library task: pff_client" ULONG CU_MPL_TT_PFF_CLIENT 1 100 0.0 4294967295.0 ECU_ADDRESS 0x40005b10 BYTE_ORDER MSB_FIRST /end MEASUREMENT
/begin COMPU_METHOD CU_MPL_TT_PFF_CLIENT "Conversion method for mpl_tt_pff_client" RAT_FUNC "%10.0" "microseconds" COEFFS 0.000000 80.000000 0.000000 0.000000 0.000000 1.000000 /end COMPU_METHOD
/* Scalar measurable for DDE 'mpl_tt_pfs_client'. */
/begin MEASUREMENT mpl_tt_pfs_client "Duration of library task: pfs_client" ULONG CU_MPL_TT_PFS_CLIENT 1 100 0.0 4294967295.0 ECU_ADDRESS 0x40005b14 BYTE_ORDER MSB_FIRST /end MEASUREMENT
/begin COMPU_METHOD CU_MPL_TT_PFS_CLIENT "Conversion method for mpl_tt_pfs_client" RAT_FUNC "%10.0" "microseconds" COEFFS 0.000000 80.000000 0.000000 0.000000 0.000000 1.000000 /end COMPU_METHOD
/* Scalar measurable for DDE 'mpl_tt_piso_client_task'. */
/begin MEASUREMENT mpl_tt_piso_client_task "Duration of library task: piso_client_task" ULONG CU_MPL_TT_PISO_CLIENT_TASK 1 100 0.0 4294967295.0 ECU_ADDRESS 0x40005b18 BYTE_ORDER MSB_FIRST /end MEASUREMENT
/begin COMPU_METHOD CU_MPL_TT_PISO_CLIENT_TASK "Conversion method for mpl_tt_piso_client_task" RAT_FUNC "%10.0" "microseconds" COEFFS 0.000000 80.000000 0.000000 0.000000 0.000000 1.000000 /end COMPU_METHOD
/* Scalar measurable for DDE 'mpl_tt_pj1939_client'. */
/begin MEASUREMENT mpl_tt_pj1939_client "Duration of library task: pj1939_client" ULONG CU_MPL_TT_PJ1939_CLIENT 1 100 0.0 4294967295.0 ECU_ADDRESS 0x40005b0c BYTE_ORDER MSB_FIRST /end MEASUREMENT
/begin COMPU_METHOD CU_MPL_TT_PJ1939_CLIENT "Conversion method for mpl_tt_pj1939_client" RAT_FUNC "%10.0" "microseconds" COEFFS 0.000000 80.000000 0.000000 0.000000 0.000000 1.000000 /end COMPU_METHOD
/* Scalar measurable for DDE 'mpl_tt_psc_watchdog'. */
/begin MEASUREMENT mpl_tt_psc_watchdog "Duration of library task: psc_watchdog" ULONG CU_MPL_TT_PSC_WATCHDOG 1 100 0.0 4294967295.0 ECU_ADDRESS 0x40005b38 BYTE_ORDER MSB_FIRST /end MEASUREMENT
/begin COMPU_METHOD CU_MPL_TT_PSC_WATCHDOG "Conversion method for mpl_tt_psc_watchdog" RAT_FUNC "%10.0" "microseconds" COEFFS 0.000000 80.000000 0.000000 0.000000 0.000000 1.000000 /end COMPU_METHOD
/* Scalar measurable for DDE 'mpl_tt_psp_periodic'. */
/begin MEASUREMENT mpl_tt_psp_periodic "Duration of library task: psp_periodic" ULONG CU_MPL_TT_PSP_PERIODIC 1 100 0.0 4294967295.0 ECU_ADDRESS 0x40005b34 BYTE_ORDER MSB_FIRST /end MEASUREMENT
/begin COMPU_METHOD CU_MPL_TT_PSP_PERIODIC "Conversion method for mpl_tt_psp_periodic" RAT_FUNC "%10.0" "microseconds" COEFFS 0.000000 80.000000 0.000000 0.000000 0.000000 1.000000 /end COMPU_METHOD
/* Scalar measurable for DDE 'mpl_tt_psp_receive'. */
/begin MEASUREMENT mpl_tt_psp_receive "Duration of library task: psp_receive" ULONG CU_MPL_TT_PSP_RECEIVE 1 100 0.0 4294967295.0 ECU_ADDRESS 0x40005b04 BYTE_ORDER MSB_FIRST /end MEASUREMENT
/begin COMPU_METHOD CU_MPL_TT_PSP_RECEIVE "Conversion method for mpl_tt_psp_receive" RAT_FUNC "%10.0" "microseconds" COEFFS 0.000000 80.000000 0.000000 0.000000 0.000000 1.000000 /end COMPU_METHOD
/* Scalar measurable for DDE 'mpl_tt_pss_task'. */
/begin MEASUREMENT mpl_tt_pss_task "Duration of library task: pss_task" ULONG CU_MPL_TT_PSS_TASK 1 100 0.0 4294967295.0 ECU_ADDRESS 0x40005af8 BYTE_ORDER MSB_FIRST /end MEASUREMENT
/begin COMPU_METHOD CU_MPL_TT_PSS_TASK "Conversion method for mpl_tt_pss_task" RAT_FUNC "%10.0" "microseconds" COEFFS 0.000000 80.000000 0.000000 0.000000 0.000000 1.000000 /end COMPU_METHOD
/* Scalar measurable for DDE 'mpl_tt_task_1000ms'. */
/begin MEASUREMENT mpl_tt_task_1000ms "Duration of application task: task_1000ms" ULONG CU_MPL_TT_TASK_1000MS 1 100 0.0 4294967295.0 ECU_ADDRESS 0x40005b24 BYTE_ORDER MSB_FIRST /end MEASUREMENT
/begin COMPU_METHOD CU_MPL_TT_TASK_1000MS "Conversion method for mpl_tt_task_1000ms" RAT_FUNC "%10.0" "microseconds" COEFFS 0.000000 80.000000 0.000000 0.000000 0.000000 1.000000 /end COMPU_METHOD
/* Scalar measurable for DDE 'mpl_tt_task_10ms'. */
/begin MEASUREMENT mpl_tt_task_10ms "Duration of application task: task_10ms" ULONG CU_MPL_TT_TASK_10MS 1 100 0.0 4294967295.0 ECU_ADDRESS 0x40005b20 BYTE_ORDER MSB_FIRST /end MEASUREMENT
/begin COMPU_METHOD CU_MPL_TT_TASK_10MS "Conversion method for mpl_tt_task_10ms" RAT_FUNC "%10.0" "microseconds" COEFFS 0.000000 80.000000 0.000000 0.000000 0.000000 1.000000 /end COMPU_METHOD
/* Scalar measurable for DDE 'mpl_unstable_reset_count'. */
/begin MEASUREMENT mpl_unstable_reset_count "Number of resets since power-up, or since the application was last stable." ULONG CU_MPL_UNSTABLE_RESET_COUNT 1 100 0.0 4294967295.0 ECU_ADDRESS 0x400025ec BYTE_ORDER MSB_FIRST /end MEASUREMENT
/begin COMPU_METHOD CU_MPL_UNSTABLE_RESET_COUNT "Conversion method for mpl_unstable_reset_count" RAT_FUNC "%10.0" "events" COEFFS 0.000000 1.000000 0.000000 0.000000 0.000000 1.000000 /end COMPU_METHOD
/* String calibration for DDE 'mpls_app_build_time'. */
/begin CHARACTERISTIC mpls_app_build_time "Date and time of app build." ASCII 0x40870 RL_MPLS_APP_BUILD_TIME 0 CU_MPLS_APP_BUILD_TIME 0 255 NUMBER 26 /end CHARACTERISTIC
/begin RECORD_LAYOUT RL_MPLS_APP_BUILD_TIME FNC_VALUES 1 UBYTE COLUMN_DIR DIRECT /end RECORD_LAYOUT
/begin COMPU_METHOD CU_MPLS_APP_BUILD_TIME "Conversion method for mpls_app_build_time" RAT_FUNC "%10.0" "" COEFFS 0.0 1.0 0.0 0.0 0.0 1.0 /end COMPU_METHOD
/* String calibration for DDE 'mpls_app_copyright'. */
/begin CHARACTERISTIC mpls_app_copyright "The application copyright text." ASCII 0x40aa0 RL_MPLS_APP_COPYRIGHT 0 CU_MPLS_APP_COPYRIGHT 0 255 NUMBER 6 /end CHARACTERISTIC
/begin RECORD_LAYOUT RL_MPLS_APP_COPYRIGHT FNC_VALUES 1 UBYTE COLUMN_DIR DIRECT /end RECORD_LAYOUT
/begin COMPU_METHOD CU_MPLS_APP_COPYRIGHT "Conversion method for mpls_app_copyright" RAT_FUNC "%10.0" "" COEFFS 0.0 1.0 0.0 0.0 0.0 1.0 /end COMPU_METHOD
/* String calibration for DDE 'mpls_app_description'. */
/begin CHARACTERISTIC mpls_app_description "Description from the application." ASCII 0x408a8 RL_MPLS_APP_DESCRIPTION 0 CU_MPLS_APP_DESCRIPTION 0 255 NUMBER 16 /end CHARACTERISTIC
/begin RECORD_LAYOUT RL_MPLS_APP_DESCRIPTION FNC_VALUES 1 UBYTE COLUMN_DIR DIRECT /end RECORD_LAYOUT
/begin COMPU_METHOD CU_MPLS_APP_DESCRIPTION "Conversion method for mpls_app_description" RAT_FUNC "%10.0" "" COEFFS 0.0 1.0 0.0 0.0 0.0 1.0 /end COMPU_METHOD
/* String calibration for DDE 'mpls_app_name'. */
/begin CHARACTERISTIC mpls_app_name "The application name." ASCII 0x4088c RL_MPLS_APP_NAME 0 CU_MPLS_APP_NAME 0 255 NUMBER 25 /end CHARACTERISTIC
/begin RECORD_LAYOUT RL_MPLS_APP_NAME FNC_VALUES 1 UBYTE COLUMN_DIR DIRECT /end RECORD_LAYOUT
/begin COMPU_METHOD CU_MPLS_APP_NAME "Conversion method for mpls_app_name" RAT_FUNC "%10.0" "" COEFFS 0.0 1.0 0.0 0.0 0.0 1.0 /end COMPU_METHOD
/* String calibration for DDE 'mpls_app_version'. */
/begin CHARACTERISTIC mpls_app_version "The application version." ASCII 0x40a98 RL_MPLS_APP_VERSION 0 CU_MPLS_APP_VERSION 0 255 NUMBER 5 /end CHARACTERISTIC
/begin RECORD_LAYOUT RL_MPLS_APP_VERSION FNC_VALUES 1 UBYTE COLUMN_DIR DIRECT /end RECORD_LAYOUT
/begin COMPU_METHOD CU_MPLS_APP_VERSION "Conversion method for mpls_app_version" RAT_FUNC "%10.0" "" COEFFS 0.0 1.0 0.0 0.0 0.0 1.0 /end COMPU_METHOD
/* String calibration for DDE 'mpls_plat_build_time'. */
/begin CHARACTERISTIC mpls_plat_build_time "Date and time of platform build." ASCII 0x40434 RL_MPLS_PLAT_BUILD_TIME 0 CU_MPLS_PLAT_BUILD_TIME 0 255 NUMBER 30 /end CHARACTERISTIC
/begin RECORD_LAYOUT RL_MPLS_PLAT_BUILD_TIME FNC_VALUES 1 UBYTE COLUMN_DIR DIRECT /end RECORD_LAYOUT
/begin COMPU_METHOD CU_MPLS_PLAT_BUILD_TIME "Conversion method for mpls_plat_build_time" RAT_FUNC "%10.0" "" COEFFS 0.0 1.0 0.0 0.0 0.0 1.0 /end COMPU_METHOD
/* String calibration for DDE 'mpls_plat_copyright'. */
/begin CHARACTERISTIC mpls_plat_copyright "Date and time of platform build." ASCII 0x4045c RL_MPLS_PLAT_COPYRIGHT 0 CU_MPLS_PLAT_COPYRIGHT 0 255 NUMBER 29 /end CHARACTERISTIC
/begin RECORD_LAYOUT RL_MPLS_PLAT_COPYRIGHT FNC_VALUES 1 UBYTE COLUMN_DIR DIRECT /end RECORD_LAYOUT
/begin COMPU_METHOD CU_MPLS_PLAT_COPYRIGHT "Conversion method for mpls_plat_copyright" RAT_FUNC "%10.0" "" COEFFS 0.0 1.0 0.0 0.0 0.0 1.0 /end COMPU_METHOD
/* String calibration for DDE 'mpls_plat_target'. */
/begin CHARACTERISTIC mpls_plat_target "Target platform." ASCII 0x40454 RL_MPLS_PLAT_TARGET 0 CU_MPLS_PLAT_TARGET 0 255 NUMBER 4 /end CHARACTERISTIC
/begin RECORD_LAYOUT RL_MPLS_PLAT_TARGET FNC_VALUES 1 UBYTE COLUMN_DIR DIRECT /end RECORD_LAYOUT
/begin COMPU_METHOD CU_MPLS_PLAT_TARGET "Conversion method for mpls_plat_target" RAT_FUNC "%10.0" "" COEFFS 0.0 1.0 0.0 0.0 0.0 1.0 /end COMPU_METHOD
/* String calibration for DDE 'mpls_plat_version'. */
/begin CHARACTERISTIC mpls_plat_version "Version of platform." ASCII 0x4047c RL_MPLS_PLAT_VERSION 0 CU_MPLS_PLAT_VERSION 0 255 NUMBER 13 /end CHARACTERISTIC
/begin RECORD_LAYOUT RL_MPLS_PLAT_VERSION FNC_VALUES 1 UBYTE COLUMN_DIR DIRECT /end RECORD_LAYOUT
/begin COMPU_METHOD CU_MPLS_PLAT_VERSION "Conversion method for mpls_plat_version" RAT_FUNC "%10.0" "" COEFFS 0.0 1.0 0.0 0.0 0.0 1.0 /end COMPU_METHOD
/* Scalar calibration for DDE 'pj1939c_node_addr_0'. */
/begin CHARACTERISTIC pj1939c_node_addr_0 "J1939 node address set up during initialisation" VALUE 0x4042c RL_PJ1939C_NODE_ADDR_0 253.000000 CU_PJ1939C_NODE_ADDR_0 0.000000 253.000000 BYTE_ORDER MSB_FIRST /end CHARACTERISTIC
/begin RECORD_LAYOUT RL_PJ1939C_NODE_ADDR_0 FNC_VALUES 1 UBYTE COLUMN_DIR DIRECT /end RECORD_LAYOUT
/begin COMPU_METHOD CU_PJ1939C_NODE_ADDR_0 "Conversion method for pj1939c_node_addr_0" RAT_FUNC "%10.0" "none" COEFFS 0.000000 1.000000 0.000000 0.000000 0.000000 1.000000 /end COMPU_METHOD
/* Scalar measurable for DDE 'wmp_app_code_day'. */
/begin MEASUREMENT wmp_app_code_day "Day the application code was built." UWORD CU_WMP_APP_CODE_DAY 1 100 0.0 0.0 ECU_ADDRESS 0x4000244a BYTE_ORDER MSB_FIRST /end MEASUREMENT
/begin COMPU_METHOD CU_WMP_APP_CODE_DAY "Conversion method for wmp_app_code_day" RAT_FUNC "%10.0" "(not defined)" COEFFS 0.000000 1.000000 0.000000 0.000000 0.000000 1.000000 /end COMPU_METHOD
/* Scalar measurable for DDE 'wmp_app_code_major_ver'. */
/begin MEASUREMENT wmp_app_code_major_ver "Major version of the application code." UWORD CU_WMP_APP_CODE_MAJOR_VER 1 100 0.0 0.0 ECU_ADDRESS 0x40002454 BYTE_ORDER MSB_FIRST /end MEASUREMENT
/begin COMPU_METHOD CU_WMP_APP_CODE_MAJOR_VER "Conversion method for wmp_app_code_major_ver" RAT_FUNC "%10.0" "(not defined)" COEFFS 0.000000 1.000000 0.000000 0.000000 0.000000 1.000000 /end COMPU_METHOD
/* Scalar measurable for DDE 'wmp_app_code_minor_ver'. */
/begin MEASUREMENT wmp_app_code_minor_ver "Minor version of the application code." UWORD CU_WMP_APP_CODE_MINOR_VER 1 100 0.0 0.0 ECU_ADDRESS 0x40002452 BYTE_ORDER MSB_FIRST /end MEASUREMENT
/begin COMPU_METHOD CU_WMP_APP_CODE_MINOR_VER "Conversion method for wmp_app_code_minor_ver" RAT_FUNC "%10.0" "(not defined)" COEFFS 0.000000 1.000000 0.000000 0.000000 0.000000 1.000000 /end COMPU_METHOD
/* Scalar measurable for DDE 'wmp_app_code_month'. */
/begin MEASUREMENT wmp_app_code_month "Month the application code was built." UWORD CU_WMP_APP_CODE_MONTH 1 100 0.0 0.0 ECU_ADDRESS 0x4000244c BYTE_ORDER MSB_FIRST /end MEASUREMENT
/begin COMPU_METHOD CU_WMP_APP_CODE_MONTH "Conversion method for wmp_app_code_month" RAT_FUNC "%10.0" "(not defined)" COEFFS 0.000000 1.000000 0.000000 0.000000 0.000000 1.000000 /end COMPU_METHOD
/* Scalar measurable for DDE 'wmp_app_code_subminor_ver'. */
/begin MEASUREMENT wmp_app_code_subminor_ver "Sub-minor version of the application code." UWORD CU_WMP_APP_CODE_SUBMINOR_VER 1 100 0.0 0.0 ECU_ADDRESS 0x40002450 BYTE_ORDER MSB_FIRST /end MEASUREMENT
/begin COMPU_METHOD CU_WMP_APP_CODE_SUBMINOR_VER "Conversion method for wmp_app_code_subminor_ver" RAT_FUNC "%10.0" "(not defined)" COEFFS 0.000000 1.000000 0.000000 0.000000 0.000000 1.000000 /end COMPU_METHOD
/* Scalar measurable for DDE 'wmp_app_code_year'. */
/begin MEASUREMENT wmp_app_code_year "Year the application code was built." UWORD CU_WMP_APP_CODE_YEAR 1 100 0.0 0.0 ECU_ADDRESS 0x4000244e BYTE_ORDER MSB_FIRST /end MEASUREMENT
/begin COMPU_METHOD CU_WMP_APP_CODE_YEAR "Conversion method for wmp_app_code_year" RAT_FUNC "%10.0" "(not defined)" COEFFS 0.000000 1.000000 0.000000 0.000000 0.000000 1.000000 /end COMPU_METHOD
/* Scalar measurable for DDE 'wmp_boot_code_day'. */
/begin MEASUREMENT wmp_boot_code_day "Day the boot code was built." UWORD CU_WMP_BOOT_CODE_DAY 1 100 0.0 0.0 ECU_ADDRESS 0x4000243e BYTE_ORDER MSB_FIRST /end MEASUREMENT
/begin COMPU_METHOD CU_WMP_BOOT_CODE_DAY "Conversion method for wmp_boot_code_day" RAT_FUNC "%10.0" "(not defined)" COEFFS 0.000000 1.000000 0.000000 0.000000 0.000000 1.000000 /end COMPU_METHOD
/* Scalar measurable for DDE 'wmp_boot_code_major_ver'. */
/begin MEASUREMENT wmp_boot_code_major_ver "Major version of the boot code." UWORD CU_WMP_BOOT_CODE_MAJOR_VER 1 100 0.0 0.0 ECU_ADDRESS 0x40002448 BYTE_ORDER MSB_FIRST /end MEASUREMENT
/begin COMPU_METHOD CU_WMP_BOOT_CODE_MAJOR_VER "Conversion method for wmp_boot_code_major_ver" RAT_FUNC "%10.0" "(not defined)" COEFFS 0.000000 1.000000 0.000000 0.000000 0.000000 1.000000 /end COMPU_METHOD
/* Scalar measurable for DDE 'wmp_boot_code_minor_ver'. */
/begin MEASUREMENT wmp_boot_code_minor_ver "Minor version of the boot code." UWORD CU_WMP_BOOT_CODE_MINOR_VER 1 100 0.0 0.0 ECU_ADDRESS 0x40002446 BYTE_ORDER MSB_FIRST /end MEASUREMENT
/begin COMPU_METHOD CU_WMP_BOOT_CODE_MINOR_VER "Conversion method for wmp_boot_code_minor_ver" RAT_FUNC "%10.0" "(not defined)" COEFFS 0.000000 1.000000 0.000000 0.000000 0.000000 1.000000 /end COMPU_METHOD
/* Scalar measurable for DDE 'wmp_boot_code_month'. */
/begin MEASUREMENT wmp_boot_code_month "Month the boot code was built." UWORD CU_WMP_BOOT_CODE_MONTH 1 100 0.0 0.0 ECU_ADDRESS 0x40002440 BYTE_ORDER MSB_FIRST /end MEASUREMENT
/begin COMPU_METHOD CU_WMP_BOOT_CODE_MONTH "Conversion method for wmp_boot_code_month" RAT_FUNC "%10.0" "(not defined)" COEFFS 0.000000 1.000000 0.000000 0.000000 0.000000 1.000000 /end COMPU_METHOD
/* Scalar measurable for DDE 'wmp_boot_code_subminor_ver'. */
/begin MEASUREMENT wmp_boot_code_subminor_ver "Sub-minor version of the boot code." UWORD CU_WMP_BOOT_CODE_SUBMINOR_VER 1 100 0.0 0.0 ECU_ADDRESS 0x40002444 BYTE_ORDER MSB_FIRST /end MEASUREMENT
/begin COMPU_METHOD CU_WMP_BOOT_CODE_SUBMINOR_VER "Conversion method for wmp_boot_code_subminor_ver" RAT_FUNC "%10.0" "(not defined)" COEFFS 0.000000 1.000000 0.000000 0.000000 0.000000 1.000000 /end COMPU_METHOD
/* Scalar measurable for DDE 'wmp_boot_code_year'. */
/begin MEASUREMENT wmp_boot_code_year "Year the boot code was built." UWORD CU_WMP_BOOT_CODE_YEAR 1 100 0.0 0.0 ECU_ADDRESS 0x40002442 BYTE_ORDER MSB_FIRST /end MEASUREMENT
/begin COMPU_METHOD CU_WMP_BOOT_CODE_YEAR "Conversion method for wmp_boot_code_year" RAT_FUNC "%10.0" "(not defined)" COEFFS 0.000000 1.000000 0.000000 0.000000 0.000000 1.000000 /end COMPU_METHOD
/* Scalar measurable for DDE 'wmp_cpu_loading'. */
/begin MEASUREMENT wmp_cpu_loading "CPU loading seen in last 50ms" UBYTE CU_WMP_CPU_LOADING 1 100 0.0 0.0 ECU_ADDRESS 0x40002424 BYTE_ORDER MSB_FIRST /end MEASUREMENT
/begin COMPU_METHOD CU_WMP_CPU_LOADING "Conversion method for wmp_cpu_loading" RAT_FUNC "%10.0" "%" COEFFS 0.000000 1.000000 0.000000 0.000000 0.000000 1.000000 /end COMPU_METHOD
/* Scalar measurable for DDE 'wmp_cpu_loading_max'. */
/begin MEASUREMENT wmp_cpu_loading_max "Maximum CPU loading seen in any 50ms period" UBYTE CU_WMP_CPU_LOADING_MAX 1 100 0.0 0.0 ECU_ADDRESS 0x40002425 BYTE_ORDER MSB_FIRST /end MEASUREMENT
/begin COMPU_METHOD CU_WMP_CPU_LOADING_MAX "Conversion method for wmp_cpu_loading_max" RAT_FUNC "%10.0" "%" COEFFS 0.000000 1.000000 0.000000 0.000000 0.000000 1.000000 /end COMPU_METHOD
/* Scalar measurable for DDE 'wmp_platform_code_day'. */
/begin MEASUREMENT wmp_platform_code_day "Day the platform library code was built." UWORD CU_WMP_PLATFORM_CODE_DAY 1 100 0.0 0.0 ECU_ADDRESS 0x40002426 BYTE_ORDER MSB_FIRST /end MEASUREMENT
/begin COMPU_METHOD CU_WMP_PLATFORM_CODE_DAY "Conversion method for wmp_platform_code_day" RAT_FUNC "%10.0" "(not defined)" COEFFS 0.000000 1.000000 0.000000 0.000000 0.000000 1.000000 /end COMPU_METHOD
/* Scalar measurable for DDE 'wmp_platform_code_major_ver'. */
/begin MEASUREMENT wmp_platform_code_major_ver "Major version of the platform library code." UWORD CU_WMP_PLATFORM_CODE_MAJOR_VER 1 100 0.0 0.0 ECU_ADDRESS 0x40002430 BYTE_ORDER MSB_FIRST /end MEASUREMENT
/begin COMPU_METHOD CU_WMP_PLATFORM_CODE_MAJOR_VER "Conversion method for wmp_platform_code_major_ver" RAT_FUNC "%10.0" "(not defined)" COEFFS 0.000000 1.000000 0.000000 0.000000 0.000000 1.000000 /end COMPU_METHOD
/* Scalar measurable for DDE 'wmp_platform_code_minor_ver'. */
/begin MEASUREMENT wmp_platform_code_minor_ver "Minor version of the platform library code." UWORD CU_WMP_PLATFORM_CODE_MINOR_VER 1 100 0.0 0.0 ECU_ADDRESS 0x4000242e BYTE_ORDER MSB_FIRST /end MEASUREMENT
/begin COMPU_METHOD CU_WMP_PLATFORM_CODE_MINOR_VER "Conversion method for wmp_platform_code_minor_ver" RAT_FUNC "%10.0" "(not defined)" COEFFS 0.000000 1.000000 0.000000 0.000000 0.000000 1.000000 /end COMPU_METHOD
/* Scalar measurable for DDE 'wmp_platform_code_month'. */
/begin MEASUREMENT wmp_platform_code_month "Month the platform library code was built." UWORD CU_WMP_PLATFORM_CODE_MONTH 1 100 0.0 0.0 ECU_ADDRESS 0x40002428 BYTE_ORDER MSB_FIRST /end MEASUREMENT
/begin COMPU_METHOD CU_WMP_PLATFORM_CODE_MONTH "Conversion method for wmp_platform_code_month" RAT_FUNC "%10.0" "(not defined)" COEFFS 0.000000 1.000000 0.000000 0.000000 0.000000 1.000000 /end COMPU_METHOD
/* Scalar measurable for DDE 'wmp_platform_code_subminor_ver'. */
/begin MEASUREMENT wmp_platform_code_subminor_ver "Sub-minor version of the platform library code." UWORD CU_WMP_PLATFORM_CODE_SUBMINOR_0 1 100 0.0 0.0 ECU_ADDRESS 0x4000242c BYTE_ORDER MSB_FIRST /end MEASUREMENT
/begin COMPU_METHOD CU_WMP_PLATFORM_CODE_SUBMINOR_0 "Conversion method for wmp_platform_code_subminor_ver" RAT_FUNC "%10.0" "(not defined)" COEFFS 0.000000 1.000000 0.000000 0.000000 0.000000 1.000000 /end COMPU_METHOD
/* Scalar measurable for DDE 'wmp_platform_code_year'. */
/begin MEASUREMENT wmp_platform_code_year "Year the platform library code was built." UWORD CU_WMP_PLATFORM_CODE_YEAR 1 100 0.0 0.0 ECU_ADDRESS 0x4000242a BYTE_ORDER MSB_FIRST /end MEASUREMENT
/begin COMPU_METHOD CU_WMP_PLATFORM_CODE_YEAR "Conversion method for wmp_platform_code_year" RAT_FUNC "%10.0" "(not defined)" COEFFS 0.000000 1.000000 0.000000 0.000000 0.000000 1.000000 /end COMPU_METHOD
/* Scalar measurable for DDE 'wmp_prg_code_day'. */
/begin MEASUREMENT wmp_prg_code_day "Day the reprogramming code was built." UWORD CU_WMP_PRG_CODE_DAY 1 100 0.0 0.0 ECU_ADDRESS 0x40002432 BYTE_ORDER MSB_FIRST /end MEASUREMENT
/begin COMPU_METHOD CU_WMP_PRG_CODE_DAY "Conversion method for wmp_prg_code_day" RAT_FUNC "%10.0" "(not defined)" COEFFS 0.000000 1.000000 0.000000 0.000000 0.000000 1.000000 /end COMPU_METHOD
/* Scalar measurable for DDE 'wmp_prg_code_major_ver'. */
/begin MEASUREMENT wmp_prg_code_major_ver "Major version of the reprogramming code." UWORD CU_WMP_PRG_CODE_MAJOR_VER 1 100 0.0 0.0 ECU_ADDRESS 0x4000243c BYTE_ORDER MSB_FIRST /end MEASUREMENT
/begin COMPU_METHOD CU_WMP_PRG_CODE_MAJOR_VER "Conversion method for wmp_prg_code_major_ver" RAT_FUNC "%10.0" "(not defined)" COEFFS 0.000000 1.000000 0.000000 0.000000 0.000000 1.000000 /end COMPU_METHOD
/* Scalar measurable for DDE 'wmp_prg_code_minor_ver'. */
/begin MEASUREMENT wmp_prg_code_minor_ver "Minor version of the reprogramming code." UWORD CU_WMP_PRG_CODE_MINOR_VER 1 100 0.0 0.0 ECU_ADDRESS 0x4000243a BYTE_ORDER MSB_FIRST /end MEASUREMENT
/begin COMPU_METHOD CU_WMP_PRG_CODE_MINOR_VER "Conversion method for wmp_prg_code_minor_ver" RAT_FUNC "%10.0" "(not defined)" COEFFS 0.000000 1.000000 0.000000 0.000000 0.000000 1.000000 /end COMPU_METHOD
/* Scalar measurable for DDE 'wmp_prg_code_month'. */
/begin MEASUREMENT wmp_prg_code_month "Month the reprogramming code was built." UWORD CU_WMP_PRG_CODE_MONTH 1 100 0.0 0.0 ECU_ADDRESS 0x40002434 BYTE_ORDER MSB_FIRST /end MEASUREMENT
/begin COMPU_METHOD CU_WMP_PRG_CODE_MONTH "Conversion method for wmp_prg_code_month" RAT_FUNC "%10.0" "(not defined)" COEFFS 0.000000 1.000000 0.000000 0.000000 0.000000 1.000000 /end COMPU_METHOD
/* Scalar measurable for DDE 'wmp_prg_code_subminor_ver'. */
/begin MEASUREMENT wmp_prg_code_subminor_ver "Sub-minor version of the reprogramming code." UWORD CU_WMP_PRG_CODE_SUBMINOR_VER 1 100 0.0 0.0 ECU_ADDRESS 0x40002438 BYTE_ORDER MSB_FIRST /end MEASUREMENT
/begin COMPU_METHOD CU_WMP_PRG_CODE_SUBMINOR_VER "Conversion method for wmp_prg_code_subminor_ver" RAT_FUNC "%10.0" "(not defined)" COEFFS 0.000000 1.000000 0.000000 0.000000 0.000000 1.000000 /end COMPU_METHOD
/* Scalar measurable for DDE 'wmp_prg_code_year'. */
/begin MEASUREMENT wmp_prg_code_year "Year the reprogramming code was built." UWORD CU_WMP_PRG_CODE_YEAR 1 100 0.0 0.0 ECU_ADDRESS 0x40002436 BYTE_ORDER MSB_FIRST /end MEASUREMENT
/begin COMPU_METHOD CU_WMP_PRG_CODE_YEAR "Conversion method for wmp_prg_code_year" RAT_FUNC "%10.0" "(not defined)" COEFFS 0.000000 1.000000 0.000000 0.000000 0.000000 1.000000 /end COMPU_METHOD
/* Scalar measurable for DDE 'wmp_stack_used'. */
/begin MEASUREMENT wmp_stack_used "Amount of used stack" ULONG CU_WMP_STACK_USED 1 100 0.0 0.0 ECU_ADDRESS 0x40002460 BYTE_ORDER MSB_FIRST /end MEASUREMENT
/begin COMPU_METHOD CU_WMP_STACK_USED "Conversion method for wmp_stack_used" RAT_FUNC "%10.0" "bytes" COEFFS 0.000000 1.000000 0.000000 0.000000 0.000000 1.000000 /end COMPU_METHOD
/* Scalar measurable for DDE 'wmp_task_duration_1s'. */
/begin MEASUREMENT wmp_task_duration_1s "Duration of 1s task (last measured valued)" ULONG CU_WMP_TASK_DURATION_1S 1 100 0.0 0.0 ECU_ADDRESS 0x40002458 BYTE_ORDER MSB_FIRST /end MEASUREMENT
/begin COMPU_METHOD CU_WMP_TASK_DURATION_1S "Conversion method for wmp_task_duration_1s" RAT_FUNC "%10.0" "microseconds" COEFFS 0.000000 1.000000 0.000000 0.000000 0.000000 1.000000 /end COMPU_METHOD
/* Scalar measurable for DDE 'wmp_task_duration_1s_max'. */
/begin MEASUREMENT wmp_task_duration_1s_max "Duration of 1s task (maximum since power up)" ULONG CU_WMP_TASK_DURATION_1S_MAX 1 100 0.0 0.0 ECU_ADDRESS 0x4000245c BYTE_ORDER MSB_FIRST /end MEASUREMENT
/begin COMPU_METHOD CU_WMP_TASK_DURATION_1S_MAX "Conversion method for wmp_task_duration_1s_max" RAT_FUNC "%10.0" "microseconds" COEFFS 0.000000 1.000000 0.000000 0.000000 0.000000 1.000000 /end COMPU_METHOD
/begin FUNCTION wmp "Group /ByDataDictionaryPrefix/wmp"
 /begin LOC_MEASUREMENT wmp_app_code_day wmp_app_code_major_ver wmp_app_code_minor_ver wmp_app_code_month wmp_app_code_subminor_ver wmp_app_code_year wmp_boot_code_day wmp_boot_code_major_ver wmp_boot_code_minor_ver wmp_boot_code_month wmp_boot_code_subminor_ver wmp_boot_code_year wmp_cpu_loading wmp_cpu_loading_max wmp_platform_code_day wmp_platform_code_major_ver wmp_platform_code_minor_ver wmp_platform_code_month wmp_platform_code_subminor_ver wmp_platform_code_year wmp_prg_code_day wmp_prg_code_major_ver wmp_prg_code_minor_ver wmp_prg_code_month wmp_prg_code_subminor_ver wmp_prg_code_year wmp_stack_used wmp_task_duration_1s wmp_task_duration_1s_max /end LOC_MEASUREMENT
/end FUNCTION
/begin FUNCTION ByDataDictionaryPrefix "Group /ByDataDictionaryPrefix" /begin SUB_FUNCTION wmp /end SUB_FUNCTION /end FUNCTION
/begin FUNCTION CPU_Status "Group /ByModelHeirarchy/testmodel/config_and_status/ECU_Status/CPU_Status"
 /begin LOC_MEASUREMENT wmp_cpu_loading wmp_cpu_loading_max wmp_stack_used wmp_task_duration_1s wmp_task_duration_1s_max /end LOC_MEASUREMENT
/end FUNCTION
/begin FUNCTION ECU_SW_Ver_AppCode "Group /ByModelHeirarchy/testmodel/config_and_status/ECU_Status/ECU_SW_Ver_AppCode"
 /begin LOC_MEASUREMENT wmp_app_code_day wmp_app_code_major_ver wmp_app_code_minor_ver wmp_app_code_month wmp_app_code_subminor_ver wmp_app_code_year /end LOC_MEASUREMENT
/end FUNCTION
/begin FUNCTION ECU_SW_Ver_Boot_Code "Group /ByModelHeirarchy/testmodel/config_and_status/ECU_Status/ECU_SW_Ver_Boot_Code"
 /begin LOC_MEASUREMENT wmp_boot_code_day wmp_boot_code_major_ver wmp_boot_code_minor_ver wmp_boot_code_month wmp_boot_code_subminor_ver wmp_boot_code_year /end LOC_MEASUREMENT
/end FUNCTION
/begin FUNCTION ECU_SW_Ver_Platform_Lib_Code "Group /ByModelHeirarchy/testmodel/config_and_status/ECU_Status/ECU_SW_Ver_Platform_Lib_Code"
 /begin LOC_MEASUREMENT wmp_prg_code_day wmp_prg_code_major_ver wmp_prg_code_minor_ver wmp_prg_code_month wmp_prg_code_subminor_ver wmp_prg_code_year /end LOC_MEASUREMENT
/end FUNCTION
/begin FUNCTION ECU_SW_Ver_Reprogramming_Code "Group /ByModelHeirarchy/testmodel/config_and_status/ECU_Status/ECU_SW_Ver_Reprogramming_Code"
 /begin LOC_MEASUREMENT wmp_platform_code_day wmp_platform_code_major_ver wmp_platform_code_minor_ver wmp_platform_code_month wmp_platform_code_subminor_ver wmp_platform_code_year /end LOC_MEASUREMENT
/end FUNCTION
/begin FUNCTION ECU_Status "Group /ByModelHeirarchy/testmodel/config_and_status/ECU_Status"
 /begin SUB_FUNCTION CPU_Status ECU_SW_Ver_AppCode ECU_SW_Ver_Boot_Code ECU_SW_Ver_Platform_Lib_Code ECU_SW_Ver_Reprogramming_Code /end SUB_FUNCTION
/end FUNCTION
/begin FUNCTION config_and_status "Group /ByModelHeirarchy/testmodel/config_and_status" /begin SUB_FUNCTION ECU_Status /end SUB_FUNCTION /end FUNCTION
/begin FUNCTION testmodel "Group /ByModelHeirarchy/testmodel" /begin SUB_FUNCTION config_and_status /end SUB_FUNCTION /end FUNCTION
/begin FUNCTION ByModelHeirarchy "Group /ByModelHeirarchy" /begin SUB_FUNCTION testmodel /end SUB_FUNCTION /end FUNCTION
/begin FUNCTION Automatic "Group /ByType/Automatic"
 /begin LOC_MEASUREMENT mpl_app_build_day mpl_app_build_hour mpl_app_build_min mpl_app_build_month mpl_app_build_sec mpl_app_build_year mpl_app_ver_major mpl_app_ver_minor mpl_app_ver_sub mpl_boot_build_day mpl_boot_build_month mpl_boot_build_year mpl_boot_part_num_group mpl_boot_part_num_id mpl_boot_part_num_issue mpl_boot_part_num_letter mpl_boot_ver_major mpl_boot_ver_minor mpl_boot_ver_sub mpl_cpu_loaded mpl_cpu_loaded_1000ms mpl_cpu_loaded_50ms mpl_ecc_flash_address mpl_ecc_ram_address mpl_flp_div_by_zero mpl_flp_inexact mpl_flp_invalid mpl_flp_overflow mpl_flp_underflow mpl_max_cpu_loaded mpl_max_cpu_loaded_1000ms mpl_max_cpu_loaded_50ms mpl_max_used_stack mpl_mtt_pan_task mpl_mtt_pcp_client mpl_mtt_pcx_can_callback mpl_mtt_pcx_periodic mpl_mtt_pcx_qemptier mpl_mtt_pdg_client_task mpl_mtt_pdtc_client_task mpl_mtt_pfc_task mpl_mtt_pff_client mpl_mtt_pfs_client mpl_mtt_piso_client_task mpl_mtt_pj1939_client mpl_mtt_psc_watchdog mpl_mtt_psp_periodic mpl_mtt_psp_receive mpl_mtt_pss_task mpl_mtt_task_1000ms mpl_mtt_task_10ms mpl_ovrc_pcp_client mpl_ovrc_pcx_can_callback mpl_ovrc_pcx_periodic mpl_ovrc_pcx_qemptier mpl_ovrc_pdg_client_task mpl_ovrc_pdtc_client_task mpl_ovrc_pfc_task mpl_ovrc_pff_client mpl_ovrc_pfs_client mpl_ovrc_piso_client_task mpl_ovrc_pj1939_client mpl_ovrc_psc_watchdog mpl_ovrc_psp_periodic mpl_ovrc_pss_task mpl_ovrc_task_1000ms mpl_ovrc_task_10ms mpl_plat_build_day mpl_plat_build_month mpl_plat_build_year mpl_plat_part_num_group mpl_plat_part_num_id mpl_plat_part_num_issue mpl_plat_part_num_letter mpl_plat_ver_major mpl_plat_ver_minor mpl_plat_ver_sub mpl_prg_build_day mpl_prg_build_month mpl_prg_build_year mpl_prg_part_num_group mpl_prg_part_num_id mpl_prg_part_num_issue mpl_prg_part_num_letter mpl_prg_ver_major mpl_prg_ver_minor mpl_prg_ver_sub mpl_reset_count mpl_run_time mpl_tt_pan_task mpl_tt_pcp_client mpl_tt_pcx_can_callback mpl_tt_pcx_periodic mpl_tt_pcx_qemptier mpl_tt_pdg_client_task mpl_tt_pdtc_client_task mpl_tt_pfc_task mpl_tt_pff_client mpl_tt_pfs_client mpl_tt_piso_client_task mpl_tt_pj1939_client mpl_tt_psc_watchdog mpl_tt_psp_periodic mpl_tt_psp_receive mpl_tt_pss_task mpl_tt_task_1000ms mpl_tt_task_10ms mpl_unstable_reset_count /end LOC_MEASUREMENT
 /begin REF_CHARACTERISTIC mpls_app_build_time mpls_app_copyright mpls_app_description mpls_app_name mpls_app_version mpls_plat_build_time mpls_plat_copyright mpls_plat_target mpls_plat_version pj1939c_node_addr_0 /end REF_CHARACTERISTIC
/end FUNCTION
/begin FUNCTION Signals "Group /ByType/Signals"
 /begin LOC_MEASUREMENT wmp_app_code_day wmp_app_code_major_ver wmp_app_code_minor_ver wmp_app_code_month wmp_app_code_subminor_ver wmp_app_code_year wmp_boot_code_day wmp_boot_code_major_ver wmp_boot_code_minor_ver wmp_boot_code_month wmp_boot_code_subminor_ver wmp_boot_code_year wmp_cpu_loading wmp_cpu_loading_max wmp_platform_code_day wmp_platform_code_major_ver wmp_platform_code_minor_ver wmp_platform_code_month wmp_platform_code_subminor_ver wmp_platform_code_year wmp_prg_code_day wmp_prg_code_major_ver wmp_prg_code_minor_ver wmp_prg_code_month wmp_prg_code_subminor_ver wmp_prg_code_year wmp_stack_used wmp_task_duration_1s wmp_task_duration_1s_max /end LOC_MEASUREMENT
/end FUNCTION
/begin FUNCTION ByType "Group /ByType" /begin SUB_FUNCTION Automatic Signals /end SUB_FUNCTION /end FUNCTION
/end MODULE
/end PROJECT
